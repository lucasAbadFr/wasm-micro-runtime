## CMakeLists.txt
```
# Copyright (C) 2019 Intel Corporation.  All rights reserved.
# SPDX-License-Identifier: Apache-2.0 WITH LLVM-exception

cmake_minimum_required(VERSION 3.8.2)

find_package(Zephyr REQUIRED HINTS $ENV{ZEPHYR_BASE})
project(wamr)

enable_language (ASM)

set (WAMR_BUILD_PLATFORM "zephyr")

# WAMR Configuration:
set (WAMR_BUILD_TARGET "THUMB")
set (WAMR_BUILD_INTERP 1)
set (WAMR_BUILD_FAST_INTERP 0)
set (WAMR_BUILD_AOT 1)
set (WAMR_BUILD_LIBC_BUILTIN 1) # printf
set (WAMR_BUILD_LIBC_WASI 1)
set (WAMR_BUILD_LIB_PTHREAD 0)
set (WAMR_BUILD_GLOBAL_HEAP_POOL 1)
# set (WAMR_BUILD_GLOBAL_HEAP_SIZE 131072) # 128 KB
# set (WAMR_BUILD_GLOBAL_HEAP_SIZE 65536) # 64 KB 
set (WAMR_BUILD_GLOBAL_HEAP_SIZE 102400) 
# Environment variables:

# Check if WAMR_ROOT_DIR is set 
if(DEFINED ENV{WAMR_ROOT_DIR})
  set(WAMR_ROOT_DIR $ENV{WAMR_ROOT_DIR})
else()
  message(FATAL_ERROR "'WAMR_ROOT_DIR' need to be specified")
endif()
message("wamr was found at ${WAMR_ROOT_DIR}")

# Check if WASI_SDK_PATH is set 
if(NOT $ENV{WASI_SDK_PATH} STREQUAL "")
  set(WASI_SDK_PATH $ENV{WASI_SDK_PATH})
else()
  find_program(WASM_C_COMPILER clang /opt/wasi-sdk/bin NO_DEFAULT_PATH)
  if(NOT WASM_C_COMPILER)
    message(FATAL_ERROR "'wasi-sdk' not found, please ensure wasi-sdk is installed.\
                         You can download and install it from\
                         https://github.com/WebAssembly/wasi-sdk/releases")
  else()
    set(WASI_SDK_PATH /opt/wasi-sdk)
  endif()
endif()
message("wasi-sdk was found at ${WASI_SDK_PATH}")

# Check if WAMR_APP_FRAMEWORK_DIR is set
if (DEFINED ENV{WAMR_APP_FRAMEWORK_DIR})
  set(WAMR_APP_FRAMEWORK_DIR $ENV{WAMR_APP_FRAMEWORK_DIR})
else()
  message(FATAL_ERROR "'wamr-app-framework' not found, please ensure they are installed.\
                       You can download and install them from\
                       https://github.com/bytecodealliance/wamr-app-framework")
endif()
message("wamr-app-framework was found at ${WAMR_APP_FRAMEWORK_DIR}")

# set the WAMR_SDK_DIR with the path specified in the environment variable
set(WAMR_SDK_DIR
    ${WAMR_APP_FRAMEWORK_DIR}/wamr-sdk
)

# set the WAMR_LIBC_BUILTIN_DIR
set(WAMR_LIBC_BUILTIN_DIR
    ${WAMR_SDK_DIR}/wamr-sdk/app/libc-builtin-sysroot
)

# set the WAMR_SDK_PACKAGE_OUT_DIR 
set(WAMR_SDK_PACKAGE_OUT_DIR
    ${CMAKE_CURRENT_BINARY_DIR}/wamr-sdk/app-sdk/wamr-app-framework
)

# # Reset linker flags
# set(CMAKE_SHARED_LIBRARY_LINK_C_FLAGS "")
# set(CMAKE_SHARED_LIBRARY_LINK_CXX_FLAGS "")

include (${WAMR_ROOT_DIR}/build-scripts/runtime_lib.cmake)
# include (${SHARED_DIR}/utils/uncommon/shared_uncommon.cmake) # in socket-api sample

# Set all benchmark by default
if(DEFINED ENV{MANUAL_BENCHMARKS})
  message(STATUS "MANUAL_BENCHMARKS is set.")
else()
  message(STATUS "MANUAL_BENCHMARKS is not set, default to all benchmarks.")
  set(ALL_BENCHMARKS 1)
endif()

add_subdirectory(wasm-apps)

# Set the benchmark definitions
target_compile_definitions(app PRIVATE ${BENCHMARK_DEFINITIONS})

# Force the POSIX API, because frozen in Kconfig
target_compile_definitions(app PRIVATE CONFIG_POSIX_API=1)

# Build the WAMR runtime 
target_sources(app PRIVATE
               ${WAMR_RUNTIME_LIB_SOURCE}
               ${BENCH_NATIVE_OBJECT}
               src/benchmark.c
               src/main.c)


# Link libraries like in samples.
set(WASI_LIBM "${WASI_SDK_PATH}/share/wasi-sysroot/lib/wasm32-wasi/libm.a")
set(WASI_LIBDL "${WASI_SDK_PATH}/share/wasi-sysroot/lib/wasm32-wasi/libdl.a")

target_link_libraries(app PUBLIC ${WASI_LIBM} ${WASI_LIBDL})
```

## prj.conf
```kconfig
# Copyright (C) 2019 Intel Corporation.  All rights reserved.
# SPDX-License-Identifier: Apache-2.0 WITH LLVM-exception

# Log config
CONFIG_PRINTK=y
CONFIG_LOG=y
CONFIG_LOG_MODE_IMMEDIATE=y  
# CONFIG_LOG_MODE_DEFERRED=y

CONFIG_MAIN_STACK_SIZE=49152
# 65536
# CONFIG_HEAP_MEM_POOL_SIZE=65536
CONFIG_REQUIRES_FULL_LIBC=y

# Stack conf
CONFIG_STACK_SENTINEL=y
CONFIG_HW_STACK_PROTECTION=y

# CONFIG_NO_OPTIMIZATIONS=y

# Config for libc-wasi
# Config File System
CONFIG_FILE_SYSTEM=y
CONFIG_FILE_SYSTEM_LITTLEFS=y 
# CONFIG_FS_LITTLEFS_BLK_DEV=y
# CONFIG_FS_LITTLEFS_FMP_DEV=y

# Temp Build Network stack to compile.
CONFIG_NETWORKING=y
CONFIG_NET_IPV4=y
CONFIG_NET_IPV6=y
CONFIG_NET_TCP=y
CONFIG_NET_SOCKETS=y

# CONFIG_POSIX_AEP_CHOICE_PSE51=y
CONFIG_POSIX_NETWORKING=y
CONFIG_POSIX_FD_MGMT=y
CONFIG_POSIX_API=y
# From Zephyr doc:
# Historically, Zephyr used CONFIG_POSIX_API to configure a set of POSIX features that was overloaded and always increasing in size.
#     * CONFIG_POSIX_API
# The option is now frozen, and can be considered equivalent to the following:
#     * CONFIG_POSIX_AEP_CHOICE_PSE51
#     * CONFIG_POSIX_FD_MGMT
#     * CONFIG_POSIX_MESSAGE_PASSING
#     * CONFIG_POSIX_NETWORKING

# Network config
CONFIG_NET_CONFIG_SETTINGS=y
CONFIG_NET_CONFIG_NEED_IPV4=y
CONFIG_NET_CONFIG_MY_IPV4_ADDR="192.0.2.1"
CONFIG_NET_CONFIG_PEER_IPV4_ADDR="192.0.2.2"
CONFIG_NET_CONFIG_MY_IPV4_GW="192.0.2.2"

# Random generator
CONFIG_TEST_RANDOM_GENERATOR=y

# Flash
CONFIG_FLASH=y
CONFIG_FLASH_MAP=y

# Debug
CONFIG_DEBUG=y
```

## src/main.c
```c
/*
 * Copyright (C) 2019 Intel Corporation.  All rights reserved.
 * SPDX-License-Identifier: Apache-2.0 WITH LLVM-exception
 */

// #include <autoconf.h>

#include <stdlib.h>
#include <string.h>
#include "bh_platform.h"
#include "bh_assert.h"
#include "bh_log.h"
#include "wasm_export.h"
#include <zephyr/kernel.h>
#include <zephyr/device.h>
#include <zephyr/devicetree.h>
#include <zephyr/logging/log.h>
#include <unistd.h>

#define CONFIG_HEAP_MEM_POOL_SIZE WASM_GLOBAL_HEAP_SIZE
#define CONFIG_APP_STACK_SIZE 8192 // 16384 // 8192 
#define CONFIG_APP_HEAP_SIZE 8192 // 16384 // 8192

LOG_MODULE_REGISTER(main);

static char global_heap_buf[CONFIG_HEAP_MEM_POOL_SIZE] = { 0 };

static int app_argc;
static char **app_argv;

//-------------------------------------------------------------------------------------------//
#if WASM_ENABLE_LIBC_WASI != 0
#include <zephyr/fs/fs.h>
#include <zephyr/fs/littlefs.h>

static int littlefs_flash_erase(unsigned int id)
{
	const struct flash_area *pfa;
	int rc;

	rc = flash_area_open(id, &pfa);
	if (rc < 0) {
		LOG_ERR("FAIL: unable to find flash area %u: %d\n",
			id, rc);
		return rc;
	}

	LOG_PRINTK("Area %u at 0x%x on %s for %u bytes\n",
		   id, (unsigned int)pfa->fa_off, pfa->fa_dev->name,
		   (unsigned int)pfa->fa_size);

	/* Optional wipe flash contents */
	if (IS_ENABLED(CONFIG_APP_WIPE_STORAGE)) {
		rc = flash_area_erase(pfa, 0, pfa->fa_size);
		LOG_ERR("Erasing flash area ... %d", rc);
	}

	flash_area_close(pfa);
	return rc;
}
#define PARTITION_NODE DT_NODELABEL(lfs1)

#if DT_NODE_EXISTS(PARTITION_NODE)
FS_FSTAB_DECLARE_ENTRY(PARTITION_NODE);
#else /* PARTITION_NODE */
FS_LITTLEFS_DECLARE_DEFAULT_CONFIG(storage);
static struct fs_mount_t lfs_storage_mnt = {
	.type = FS_LITTLEFS,
	.fs_data = &storage,
	.storage_dev = (void *)FIXED_PARTITION_ID(storage_partition),
	.mnt_point = "/lfs",
};
#endif /* PARTITION_NODE */

	struct fs_mount_t *mountpoint =
#if DT_NODE_EXISTS(PARTITION_NODE)
		&FS_FSTAB_ENTRY(PARTITION_NODE)
#else
		&lfs_storage_mnt
#endif
		;

static int littlefs_mount(struct fs_mount_t *mp)
{
	int rc;

	rc = littlefs_flash_erase((uintptr_t)mp->storage_dev);
	if (rc < 0) {
		return rc;
	}

	/* Do not mount if auto-mount has been enabled */
#if !DT_NODE_EXISTS(PARTITION_NODE) ||						\
	!(FSTAB_ENTRY_DT_MOUNT_FLAGS(PARTITION_NODE) & FS_MOUNT_FLAG_AUTOMOUNT)
	rc = fs_mount(mp);
	if (rc < 0) {
		LOG_PRINTK("FAIL: mount id %" PRIuPTR " at %s: %d\n",
		       (uintptr_t)mp->storage_dev, mp->mnt_point, rc);
		return rc;
	}
	LOG_PRINTK("%s mount: %d\n", mp->mnt_point, rc);
#else
	LOG_PRINTK("%s automounted\n", mp->mnt_point);
#endif

	return 0;
}
#endif 

//-------------------------------------------------------------------------------------------//
static uint64_t wasm_bench_start_time = 0;
static uint64_t wasm_bench_end_time = 0;

__attribute__((noinline))
void wasm_bench_start(wasm_exec_env_t exec_env){
    printk("[DEBUG] measure start time\n");
    wasm_bench_start_time =  k_cycle_get_32();
    __asm__ volatile(""); // Acts as a compiler barrier
}

__attribute__((noinline))
void wasm_bench_end(wasm_exec_env_t exec_env){
    __asm__ volatile(""); // Acts as a compiler barrier
    wasm_bench_end_time =  k_cycle_get_32();
    printk("[DEBUG] measure end time\n");
}

void wasm_reset_times(){
    wasm_bench_start_time = 0;
    wasm_bench_end_time = 0;
}
static NativeSymbol native_symbols[] =
{
    {
        "bench_start",
     	wasm_bench_start,
        "()"
    },
    {
        "bench_end",
        wasm_bench_end,
        "()"
    }
};

//-------------------------------------------------------------------------------------------//
#include "native_benchmark.h"
/* array conataining every benchmark info*/
extern Benchmark benchmarks[10];
extern int bench_nb;

/* fucntion to load an run a benchmark */
bool load_and_run_bench(const Benchmark *benchmark) {
    wasm_module_t wasm_module = NULL;
    wasm_module_inst_t wasm_module_inst = NULL;
    wasm_function_inst_t func = NULL;
    const char *exception;
    int func_argv[1];
    char error_buf[128];

    /* Load WASM module */
    if (!(wasm_module = wasm_runtime_load(benchmark->wasm_module, benchmark->wasm_module_size, error_buf, sizeof(error_buf)))) {
        LOG_ERR("Failed to load module: %s", error_buf);
        return false;
    }

        /* Set the WASI context */
#if WASM_ENABLE_LIBC_WASI != 0
    #if BENCHMARK_FS
    #define DIR_LIST_SIZE 1
        const char *dir_list[DIR_LIST_SIZE] = {
            "/lfs",};
        wasm_runtime_set_wasi_args(wasm_module, dir_list, DIR_LIST_SIZE, NULL, 0, NULL, 0, NULL, 0);
    #elif BENCHMARK_SOCKET
        #define ADDRESS_POOL_SIZE 1
        const char *addr_pool[ADDRESS_POOL_SIZE] = {
            "192.0.2.10/24"};
        wasm_runtime_set_wasi_addr_pool(wasm_module, addr_pool, ADDRESS_POOL_SIZE);
    #endif
#endif /* WASM_ENABLE_LIBC_WASI */

    /* Instantiate the module */
    if (!(wasm_module_inst = wasm_runtime_instantiate(wasm_module, CONFIG_APP_STACK_SIZE, CONFIG_APP_HEAP_SIZE, error_buf, sizeof(error_buf)))) {
        LOG_ERR("Failed to instantiate module: %s", error_buf);
        wasm_runtime_unload(wasm_module);
        return false;
    }

    /* Invoke the main function */
    if ((func = wasm_runtime_lookup_function(wasm_module_inst, benchmark->func_name))) {
        wasm_exec_env_t exec_env = wasm_runtime_create_exec_env(wasm_module_inst, CONFIG_APP_STACK_SIZE);
        if (!exec_env) {
            LOG_ERR("Create wasm execution environment failed.");
            return -1;
        }
        wasm_runtime_call_wasm(exec_env, func, 1, func_argv);
        k_sleep(K_MSEC(1000)); // wait for execution to finish 
        wasm_runtime_destroy_exec_env(exec_env);
    }

    if ((exception = wasm_runtime_get_exception(wasm_module_inst)))
    LOG_ERR("get exception: %s", exception);
    
#if WASM_ENABLE_LIBC_WASI != 0
    int rc = wasm_runtime_get_wasi_exit_code(wasm_module_inst);
    LOG_INF("wasi exit code: %d", rc);
#endif

    /* Deinstantiate the module */
    wasm_runtime_deinstantiate(wasm_module_inst);

    /* Unload the module */
    wasm_runtime_unload(wasm_module);

    return true; // Return true if everything went well
}


//-------------------------------------------------------------------------------------------//
int main(void)
{
    int start, end;
    start = k_uptime_get_32();
    uint8 *wasm_file_buf = NULL;
    uint32 wasm_file_size;
    wasm_module_t wasm_module = NULL;
    wasm_module_inst_t wasm_module_inst = NULL;
    RuntimeInitArgs init_args;
    char error_buf[128];
    const char *exception;
    int rc;

    memset(&init_args, 0, sizeof(RuntimeInitArgs));
    memset(benchmarks, 0, sizeof(benchmarks));

    printk("timer has 64bits : %s\n", CONFIG_TIMER_HAS_64BIT_CYCLE_COUNTER ? "yes" : "no");

    /* Display info about benchmarks run */
    benchmark_banner();
    printk("\n");

    /* Initialize every benchmarks information in the benchmarks array*/
    initialize_benchmarks();

#if WASM_ENABLE_LIBC_WASI != 0
    #if BENCHMARK_FS
        rc = littlefs_mount(mountpoint);
        if (rc < 0) {
            LOG_ERR("FAIL: mounting %s: %d\n", mountpoint->mnt_point, rc);
            return 0;
        }
    #endif
#endif

#if WASM_ENABLE_GLOBAL_HEAP_POOL != 0
    init_args.mem_alloc_type = Alloc_With_Pool;
    init_args.mem_alloc_option.pool.heap_buf = global_heap_buf;
    init_args.mem_alloc_option.pool.heap_size = sizeof(global_heap_buf);
    LOG_INF("global heap size: %d", sizeof(global_heap_buf));
#else
#error "memory allocation scheme is not defined."
#endif

    /* initialize runtime environment */
    if (!wasm_runtime_full_init(&init_args)) {
        LOG_ERR("Init runtime environment failed.");
        return;
    }

    /* register native function */
    int n_native_symbols = sizeof(native_symbols) / sizeof(NativeSymbol);
    if (!wasm_runtime_register_natives("env",
                                   native_symbols,
                                   n_native_symbols)){
        LOG_ERR("Register natives failed.");
    }

    /* Load and run all wasm benchmarks */
    printk("[INFO] Running wasm benchmarks\n");
    for (int i = 0; i <= bench_nb; ++i) { 
        if(benchmarks[i].func_name != NULL){
            if(load_and_run_bench(&benchmarks[i])){
                printk("[%s] start: %llu ticks\n", benchmarks[i].func_name + 6, wasm_bench_start_time);
                printk("[%s] end: %llu ticks\n", benchmarks[i].func_name + 6, wasm_bench_end_time);
                printk("[%s] elapsed: %llu ticks\n", benchmarks[i].func_name + 6, (wasm_bench_end_time - wasm_bench_start_time));
                wasm_reset_times();
                deallocate_benchmark(&benchmarks[i]); // Deallocate the benchmark
            } else {
                LOG_ERR("Failed to run benchmark: %s", benchmarks[i].func_name);
                deallocate_benchmark(&benchmarks[i]); // Deallocate the benchmark
            } 
        }
    }

fail1:
    /* destroy runtime environment */
    wasm_runtime_destroy();
    cleanup_benchmarks();
    end = k_uptime_get_32();
    
    printk("\n");
    LOG_INF("runtime elapsed: %d ms", (end - start));
    printk("\n");
    
    /* perform native benchmarks */
    printk("[INFO] Running native benchmarks\n");
    call_bench_main();

    return 0;
}
```

## src/ackermann.h
```c
unsigned char __aligned(4) wasm_ackermann[] = { 0x00, 0x61, 0x73, 0x6d, 0x01, 0x00, 0x00, 0x00, 0x01, 0x0e, 0x03, 0x60, 0x02, 0x7f, 0x7f, 0x01, 0x7f, 0x60, 0x00, 0x00, 0x60, 0x00, 0x01, 0x7f, 0x02, 0x30, 0x03, 0x03, 0x65, 0x6e, 0x76, 0x06, 0x70, 0x72, 0x69, 0x6e, 0x74, 0x66, 0x00, 0x00, 0x03, 0x65, 0x6e, 0x76, 0x0b, 0x62, 0x65, 0x6e, 0x63, 0x68, 0x5f, 0x73, 0x74, 0x61, 0x72, 0x74, 0x00, 0x01, 0x03, 0x65, 0x6e, 0x76, 0x09, 0x62, 0x65, 0x6e, 0x63, 0x68, 0x5f, 0x65, 0x6e, 0x64, 0x00, 0x01, 0x03, 0x03, 0x02, 0x00, 0x02, 0x05, 0x03, 0x01, 0x00, 0x01, 0x06, 0x15, 0x03, 0x7f, 0x01, 0x41, 0xd0, 0xc8, 0x00, 0x0b, 0x7f, 0x00, 0x41, 0xc5, 0x08, 0x0b, 0x7f, 0x00, 0x41, 0xd0, 0xc8, 0x00, 0x0b, 0x07, 0x37, 0x04, 0x06, 0x6d, 0x65, 0x6d, 0x6f, 0x72, 0x79, 0x02, 0x00, 0x0f, 0x62, 0x65, 0x6e, 0x63, 0x68, 0x5f, 0x61, 0x63, 0x6b, 0x65, 0x72, 0x6d, 0x61, 0x6e, 0x6e, 0x00, 0x04, 0x0a, 0x5f, 0x5f, 0x64, 0x61, 0x74, 0x61, 0x5f, 0x65, 0x6e, 0x64, 0x03, 0x01, 0x0b, 0x5f, 0x5f, 0x68, 0x65, 0x61, 0x70, 0x5f, 0x62, 0x61, 0x73, 0x65, 0x03, 0x02, 0x0a, 0xaa, 0x01, 0x02, 0x3a, 0x00, 0x02, 0x40, 0x20, 0x00, 0x45, 0x0d, 0x00, 0x03, 0x40, 0x02, 0x40, 0x02, 0x40, 0x20, 0x01, 0x0d, 0x00, 0x41, 0x01, 0x21, 0x01, 0x0c, 0x01, 0x0b, 0x20, 0x00, 0x20, 0x01, 0x41, 0x7f, 0x6a, 0x10, 0x83, 0x80, 0x80, 0x80, 0x00, 0x21, 0x01, 0x0b, 0x20, 0x00, 0x41, 0x7f, 0x6a, 0x22, 0x00, 0x0d, 0x00, 0x0b, 0x0b, 0x20, 0x01, 0x41, 0x01, 0x6a, 0x0b, 0x6d, 0x01, 0x02, 0x7f, 0x23, 0x80, 0x80, 0x80, 0x80, 0x00, 0x41, 0x20, 0x6b, 0x22, 0x00, 0x24, 0x80, 0x80, 0x80, 0x80, 0x00, 0x20, 0x00, 0x42, 0x83, 0x80, 0x80, 0x80, 0x30, 0x37, 0x03, 0x10, 0x41, 0x99, 0x88, 0x80, 0x80, 0x00, 0x20, 0x00, 0x41, 0x10, 0x6a, 0x10, 0x80, 0x80, 0x80, 0x80, 0x00, 0x1a, 0x10, 0x81, 0x80, 0x80, 0x80, 0x00, 0x41, 0x03, 0x41, 0x03, 0x10, 0x83, 0x80, 0x80, 0x80, 0x00, 0x21, 0x01, 0x10, 0x82, 0x80, 0x80, 0x80, 0x00, 0x20, 0x00, 0x20, 0x01, 0x36, 0x02, 0x00, 0x41, 0x80, 0x88, 0x80, 0x80, 0x00, 0x20, 0x00, 0x10, 0x80, 0x80, 0x80, 0x80, 0x00, 0x1a, 0x20, 0x00, 0x41, 0x20, 0x6a, 0x24, 0x80, 0x80, 0x80, 0x80, 0x00, 0x20, 0x00, 0x0b, 0x0b, 0x4c, 0x01, 0x00, 0x41, 0x80, 0x08, 0x0b, 0x45, 0x5b, 0x61, 0x63, 0x6b, 0x65, 0x72, 0x6d, 0x61, 0x6e, 0x6e, 0x5d, 0x20, 0x72, 0x65, 0x74, 0x75, 0x72, 0x6e, 0x65, 0x64, 0x20, 0x25, 0x64, 0x0a, 0x00, 0x5b, 0x61, 0x63, 0x6b, 0x65, 0x72, 0x6d, 0x61, 0x6e, 0x6e, 0x5d, 0x20, 0x72, 0x75, 0x6e, 0x6e, 0x69, 0x6e, 0x67, 0x20, 0x77, 0x69, 0x74, 0x68, 0x20, 0x4d, 0x20, 0x3d, 0x20, 0x25, 0x64, 0x20, 0x61, 0x6e, 0x64, 0x20, 0x4e, 0x20, 0x3d, 0x20, 0x25, 0x64, 0x0a, 0x00, 0x00, 0x64, 0x04, 0x6e, 0x61, 0x6d, 0x65, 0x01, 0x3d, 0x05, 0x00, 0x06, 0x70, 0x72, 0x69, 0x6e, 0x74, 0x66, 0x01, 0x0b, 0x62, 0x65, 0x6e, 0x63, 0x68, 0x5f, 0x73, 0x74, 0x61, 0x72, 0x74, 0x02, 0x09, 0x62, 0x65, 0x6e, 0x63, 0x68, 0x5f, 0x65, 0x6e, 0x64, 0x03, 0x09, 0x61, 0x63, 0x6b, 0x65, 0x72, 0x6d, 0x61, 0x6e, 0x6e, 0x04, 0x0f, 0x62, 0x65, 0x6e, 0x63, 0x68, 0x5f, 0x61, 0x63, 0x6b, 0x65, 0x72, 0x6d, 0x61, 0x6e, 0x6e, 0x07, 0x12, 0x01, 0x00, 0x0f, 0x5f, 0x5f, 0x73, 0x74, 0x61, 0x63, 0x6b, 0x5f, 0x70, 0x6f, 0x69, 0x6e, 0x74, 0x65, 0x72, 0x09, 0x0a, 0x01, 0x00, 0x07, 0x2e, 0x72, 0x6f, 0x64, 0x61, 0x74, 0x61, 0x00, 0x26, 0x09, 0x70, 0x72, 0x6f, 0x64, 0x75, 0x63, 0x65, 0x72, 0x73, 0x01, 0x0c, 0x70, 0x72, 0x6f, 0x63, 0x65, 0x73, 0x73, 0x65, 0x64, 0x2d, 0x62, 0x79, 0x01, 0x05, 0x63, 0x6c, 0x61, 0x6e, 0x67, 0x06, 0x31, 0x37, 0x2e, 0x30, 0x2e, 0x36, 0x00, 0x2c, 0x0f, 0x74, 0x61, 0x72, 0x67, 0x65, 0x74, 0x5f, 0x66, 0x65, 0x61, 0x74, 0x75, 0x72, 0x65, 0x73, 0x02, 0x2b, 0x0f, 0x6d, 0x75, 0x74, 0x61, 0x62, 0x6c, 0x65, 0x2d, 0x67, 0x6c, 0x6f, 0x62, 0x61, 0x6c, 0x73, 0x2b, 0x08, 0x73, 0x69, 0x67, 0x6e, 0x2d, 0x65, 0x78, 0x74 };
```

## src/base64.h
```c
unsigned char __aligned(4) wasm_base64[] = { 0x00, 0x61, 0x73, 0x6d, 0x01, 0x00, 0x00, 0x00, 0x01, 0x1e, 0x06, 0x60, 0x01, 0x7f, 0x00, 0x60, 0x02, 0x7f, 0x7f, 0x01, 0x7f, 0x60, 0x01, 0x7f, 0x01, 0x7f, 0x60, 0x00, 0x00, 0x60, 0x03, 0x7f, 0x7f, 0x7f, 0x01, 0x7f, 0x60, 0x00, 0x01, 0x7f, 0x02, 0x6d, 0x08, 0x03, 0x65, 0x6e, 0x76, 0x06, 0x63, 0x61, 0x6c, 0x6c, 0x6f, 0x63, 0x00, 0x01, 0x03, 0x65, 0x6e, 0x76, 0x06, 0x6d, 0x61, 0x6c, 0x6c, 0x6f, 0x63, 0x00, 0x02, 0x03, 0x65, 0x6e, 0x76, 0x06, 0x70, 0x72, 0x69, 0x6e, 0x74, 0x66, 0x00, 0x01, 0x03, 0x65, 0x6e, 0x76, 0x0b, 0x62, 0x65, 0x6e, 0x63, 0x68, 0x5f, 0x73, 0x74, 0x61, 0x72, 0x74, 0x00, 0x03, 0x03, 0x65, 0x6e, 0x76, 0x04, 0x70, 0x75, 0x74, 0x73, 0x00, 0x02, 0x03, 0x65, 0x6e, 0x76, 0x06, 0x6d, 0x65, 0x6d, 0x73, 0x65, 0x74, 0x00, 0x04, 0x03, 0x65, 0x6e, 0x76, 0x09, 0x62, 0x65, 0x6e, 0x63, 0x68, 0x5f, 0x65, 0x6e, 0x64, 0x00, 0x03, 0x03, 0x65, 0x6e, 0x76, 0x04, 0x66, 0x72, 0x65, 0x65, 0x00, 0x00, 0x03, 0x03, 0x02, 0x05, 0x00, 0x04, 0x05, 0x01, 0x70, 0x01, 0x02, 0x02, 0x05, 0x03, 0x01, 0x00, 0x01, 0x06, 0x15, 0x03, 0x7f, 0x01, 0x41, 0x80, 0xc9, 0x00, 0x0b, 0x7f, 0x00, 0x41, 0xf4, 0x08, 0x0b, 0x7f, 0x00, 0x41, 0x80, 0xc9, 0x00, 0x0b, 0x07, 0x34, 0x04, 0x06, 0x6d, 0x65, 0x6d, 0x6f, 0x72, 0x79, 0x02, 0x00, 0x0c, 0x62, 0x65, 0x6e, 0x63, 0x68, 0x5f, 0x62, 0x61, 0x73, 0x65, 0x36, 0x34, 0x00, 0x08, 0x0a, 0x5f, 0x5f, 0x64, 0x61, 0x74, 0x61, 0x5f, 0x65, 0x6e, 0x64, 0x03, 0x01, 0x0b, 0x5f, 0x5f, 0x68, 0x65, 0x61, 0x70, 0x5f, 0x62, 0x61, 0x73, 0x65, 0x03, 0x02, 0x09, 0x07, 0x01, 0x00, 0x41, 0x01, 0x0b, 0x01, 0x09, 0x0a, 0x94, 0x08, 0x02, 0x8e, 0x08, 0x01, 0x10, 0x7f, 0x23, 0x80, 0x80, 0x80, 0x80, 0x00, 0x41, 0x10, 0x6b, 0x22, 0x00, 0x24, 0x80, 0x80, 0x80, 0x80, 0x00, 0x20, 0x00, 0x41, 0x0a, 0x36, 0x02, 0x0c, 0x20, 0x00, 0x41, 0x0a, 0x41, 0x01, 0x10, 0x80, 0x80, 0x80, 0x80, 0x00, 0x36, 0x02, 0x08, 0x41, 0x11, 0x10, 0x81, 0x80, 0x80, 0x80, 0x00, 0x21, 0x01, 0x20, 0x00, 0x41, 0x0c, 0x6a, 0x41, 0x00, 0x28, 0x02, 0xf0, 0x88, 0x80, 0x80, 0x00, 0x11, 0x80, 0x80, 0x80, 0x80, 0x00, 0x00, 0x20, 0x00, 0x41, 0xe8, 0x07, 0x36, 0x02, 0x04, 0x20, 0x00, 0x20, 0x00, 0x28, 0x02, 0x0c, 0x36, 0x02, 0x00, 0x41, 0xbd, 0x88, 0x80, 0x80, 0x00, 0x20, 0x00, 0x10, 0x82, 0x80, 0x80, 0x80, 0x00, 0x1a, 0x10, 0x83, 0x80, 0x80, 0x80, 0x00, 0x41, 0x00, 0x21, 0x02, 0x03, 0x40, 0x20, 0x00, 0x41, 0x08, 0x6a, 0x41, 0x00, 0x28, 0x02, 0xf0, 0x88, 0x80, 0x80, 0x00, 0x11, 0x80, 0x80, 0x80, 0x80, 0x00, 0x00, 0x02, 0x40, 0x02, 0x40, 0x02, 0x40, 0x20, 0x00, 0x28, 0x02, 0x0c, 0x22, 0x03, 0x41, 0x03, 0x6e, 0x22, 0x04, 0x41, 0x02, 0x74, 0x22, 0x05, 0x20, 0x05, 0x41, 0x04, 0x6a, 0x20, 0x04, 0x41, 0x7d, 0x6c, 0x41, 0x00, 0x20, 0x03, 0x6b, 0x46, 0x1b, 0x22, 0x06, 0x41, 0x11, 0x4f, 0x0d, 0x00, 0x02, 0x40, 0x20, 0x03, 0x0d, 0x00, 0x41, 0x00, 0x21, 0x07, 0x0c, 0x03, 0x0b, 0x20, 0x00, 0x28, 0x02, 0x08, 0x21, 0x08, 0x41, 0x00, 0x21, 0x09, 0x41, 0x00, 0x21, 0x04, 0x41, 0x00, 0x21, 0x0a, 0x41, 0x00, 0x21, 0x07, 0x0c, 0x01, 0x0b, 0x03, 0x40, 0x0c, 0x00, 0x0b, 0x0b, 0x03, 0x40, 0x20, 0x09, 0x41, 0x08, 0x74, 0x20, 0x08, 0x20, 0x0a, 0x6a, 0x2d, 0x00, 0x00, 0x22, 0x0b, 0x72, 0x21, 0x09, 0x20, 0x01, 0x20, 0x07, 0x6a, 0x21, 0x0c, 0x20, 0x04, 0x41, 0x08, 0x72, 0x41, 0x7a, 0x6a, 0x22, 0x05, 0x41, 0x06, 0x6e, 0x41, 0x01, 0x6a, 0x22, 0x0d, 0x20, 0x07, 0x6a, 0x21, 0x07, 0x03, 0x40, 0x20, 0x0c, 0x20, 0x09, 0x20, 0x05, 0x76, 0x41, 0x3f, 0x71, 0x22, 0x04, 0x41, 0xc1, 0xff, 0x00, 0x6a, 0x41, 0x7f, 0x73, 0x41, 0x08, 0x76, 0x41, 0x2f, 0x71, 0x20, 0x04, 0x41, 0xe6, 0xff, 0x03, 0x6a, 0x41, 0x08, 0x76, 0x22, 0x0e, 0x20, 0x04, 0x41, 0xc1, 0x00, 0x6a, 0x71, 0x72, 0x20, 0x04, 0x41, 0xc2, 0xff, 0x03, 0x6a, 0x41, 0x08, 0x76, 0x20, 0x04, 0x41, 0xfc, 0x01, 0x6a, 0x71, 0x20, 0x04, 0x41, 0xcc, 0xff, 0x03, 0x6a, 0x41, 0x08, 0x76, 0x22, 0x0f, 0x41, 0x7f, 0x73, 0x71, 0x72, 0x20, 0x04, 0x41, 0xc7, 0x00, 0x6a, 0x20, 0x0e, 0x41, 0x7f, 0x73, 0x71, 0x20, 0x0f, 0x71, 0x72, 0x20, 0x04, 0x41, 0xc1, 0xff, 0x00, 0x73, 0x41, 0x01, 0x6a, 0x41, 0x7f, 0x73, 0x41, 0x08, 0x76, 0x41, 0x2b, 0x71, 0x72, 0x3a, 0x00, 0x00, 0x20, 0x0c, 0x41, 0x01, 0x6a, 0x21, 0x0c, 0x20, 0x05, 0x41, 0x7a, 0x6a, 0x21, 0x05, 0x20, 0x0d, 0x41, 0x7f, 0x6a, 0x22, 0x0d, 0x0d, 0x00, 0x0b, 0x20, 0x05, 0x41, 0x06, 0x6a, 0x21, 0x04, 0x20, 0x0a, 0x41, 0x01, 0x6a, 0x22, 0x0a, 0x20, 0x03, 0x47, 0x0d, 0x00, 0x0b, 0x02, 0x40, 0x20, 0x05, 0x41, 0x7a, 0x46, 0x0d, 0x00, 0x20, 0x01, 0x20, 0x07, 0x6a, 0x20, 0x0b, 0x41, 0x00, 0x20, 0x05, 0x6b, 0x74, 0x41, 0x3f, 0x71, 0x22, 0x04, 0x41, 0xc1, 0xff, 0x00, 0x6a, 0x41, 0x7f, 0x73, 0x41, 0x08, 0x76, 0x41, 0x2f, 0x71, 0x20, 0x04, 0x41, 0xe6, 0xff, 0x03, 0x6a, 0x41, 0x08, 0x76, 0x22, 0x05, 0x20, 0x04, 0x41, 0xc1, 0x00, 0x6a, 0x71, 0x72, 0x20, 0x04, 0x41, 0xc2, 0xff, 0x03, 0x6a, 0x41, 0x08, 0x76, 0x20, 0x04, 0x41, 0xfc, 0x01, 0x6a, 0x71, 0x20, 0x04, 0x41, 0xcc, 0xff, 0x03, 0x6a, 0x41, 0x08, 0x76, 0x22, 0x0c, 0x41, 0x7f, 0x73, 0x71, 0x72, 0x20, 0x04, 0x41, 0xc7, 0x00, 0x6a, 0x20, 0x05, 0x41, 0x7f, 0x73, 0x71, 0x20, 0x0c, 0x71, 0x72, 0x20, 0x04, 0x41, 0xc1, 0xff, 0x00, 0x73, 0x41, 0x01, 0x6a, 0x41, 0x7f, 0x73, 0x41, 0x08, 0x76, 0x41, 0x2b, 0x71, 0x72, 0x3a, 0x00, 0x00, 0x20, 0x07, 0x41, 0x01, 0x6a, 0x21, 0x07, 0x0b, 0x20, 0x07, 0x20, 0x06, 0x4d, 0x0d, 0x00, 0x41, 0x80, 0x88, 0x80, 0x80, 0x00, 0x10, 0x84, 0x80, 0x80, 0x80, 0x00, 0x1a, 0x0b, 0x02, 0x40, 0x02, 0x40, 0x20, 0x06, 0x20, 0x07, 0x4b, 0x0d, 0x00, 0x20, 0x07, 0x21, 0x06, 0x0c, 0x01, 0x0b, 0x20, 0x01, 0x20, 0x07, 0x6a, 0x41, 0x3d, 0x20, 0x06, 0x20, 0x07, 0x6b, 0x10, 0x85, 0x80, 0x80, 0x80, 0x00, 0x1a, 0x0b, 0x41, 0x00, 0x21, 0x0c, 0x20, 0x01, 0x20, 0x06, 0x6a, 0x41, 0x00, 0x20, 0x06, 0x41, 0x01, 0x6a, 0x22, 0x04, 0x41, 0x11, 0x20, 0x04, 0x41, 0x11, 0x4b, 0x1b, 0x20, 0x06, 0x6b, 0x10, 0x85, 0x80, 0x80, 0x80, 0x00, 0x1a, 0x20, 0x00, 0x28, 0x02, 0x0c, 0x21, 0x09, 0x20, 0x00, 0x28, 0x02, 0x08, 0x21, 0x07, 0x41, 0x00, 0x21, 0x0d, 0x41, 0x00, 0x21, 0x0f, 0x41, 0x00, 0x21, 0x05, 0x02, 0x40, 0x03, 0x40, 0x20, 0x01, 0x20, 0x05, 0x6a, 0x2c, 0x00, 0x00, 0x22, 0x04, 0x41, 0xd0, 0xff, 0x00, 0x73, 0x41, 0x01, 0x6a, 0x41, 0x7f, 0x73, 0x41, 0x08, 0x76, 0x41, 0x3f, 0x71, 0x20, 0x04, 0x41, 0xd4, 0xff, 0x00, 0x73, 0x41, 0x01, 0x6a, 0x41, 0x7f, 0x73, 0x41, 0x08, 0x76, 0x41, 0x3e, 0x71, 0x72, 0x20, 0x04, 0x41, 0x9f, 0xff, 0x03, 0x6a, 0x41, 0x7f, 0x73, 0x41, 0xfa, 0x00, 0x20, 0x04, 0x6b, 0x41, 0x7f, 0x73, 0x71, 0x41, 0x08, 0x76, 0x20, 0x04, 0x41, 0xb9, 0x01, 0x6a, 0x71, 0x41, 0xff, 0x01, 0x71, 0x72, 0x20, 0x04, 0x41, 0xd0, 0xff, 0x03, 0x6a, 0x41, 0x7f, 0x73, 0x41, 0x39, 0x20, 0x04, 0x6b, 0x41, 0x7f, 0x73, 0x71, 0x41, 0x08, 0x76, 0x20, 0x04, 0x41, 0x04, 0x6a, 0x71, 0x41, 0xff, 0x01, 0x71, 0x72, 0x41, 0xda, 0x00, 0x20, 0x04, 0x6b, 0x41, 0x7f, 0x73, 0x20, 0x04, 0x41, 0xbf, 0x7f, 0x6a, 0x22, 0x0e, 0x41, 0x7f, 0x73, 0x71, 0x41, 0x08, 0x76, 0x20, 0x0e, 0x71, 0x41, 0xff, 0x01, 0x71, 0x72, 0x22, 0x0e, 0x41, 0x7f, 0x6a, 0x20, 0x04, 0x41, 0xbe, 0xff, 0x03, 0x73, 0x41, 0x01, 0x6a, 0x71, 0x41, 0x08, 0x76, 0x41, 0xff, 0x01, 0x71, 0x20, 0x0e, 0x72, 0x22, 0x04, 0x41, 0xff, 0x01, 0x46, 0x0d, 0x01, 0x20, 0x04, 0x20, 0x0d, 0x41, 0x06, 0x74, 0x6a, 0x21, 0x0d, 0x02, 0x40, 0x02, 0x40, 0x20, 0x0c, 0x41, 0x02, 0x4f, 0x0d, 0x00, 0x20, 0x0c, 0x41, 0x06, 0x6a, 0x21, 0x0c, 0x0c, 0x01, 0x0b, 0x20, 0x0f, 0x20, 0x09, 0x4f, 0x0d, 0x02, 0x20, 0x07, 0x20, 0x0f, 0x6a, 0x20, 0x0d, 0x20, 0x0c, 0x41, 0x7e, 0x6a, 0x22, 0x0c, 0x76, 0x3a, 0x00, 0x00, 0x20, 0x0f, 0x41, 0x01, 0x6a, 0x21, 0x0f, 0x0b, 0x20, 0x05, 0x41, 0x01, 0x6a, 0x22, 0x05, 0x41, 0x11, 0x47, 0x0d, 0x00, 0x0b, 0x0b, 0x20, 0x02, 0x41, 0x01, 0x6a, 0x22, 0x02, 0x41, 0xe8, 0x07, 0x47, 0x0d, 0x00, 0x0b, 0x10, 0x86, 0x80, 0x80, 0x80, 0x00, 0x41, 0xab, 0x88, 0x80, 0x80, 0x00, 0x10, 0x84, 0x80, 0x80, 0x80, 0x00, 0x1a, 0x20, 0x00, 0x28, 0x02, 0x08, 0x10, 0x87, 0x80, 0x80, 0x80, 0x00, 0x20, 0x01, 0x10, 0x87, 0x80, 0x80, 0x80, 0x00, 0x20, 0x00, 0x41, 0x10, 0x6a, 0x24, 0x80, 0x80, 0x80, 0x80, 0x00, 0x20, 0x04, 0x0b, 0x02, 0x00, 0x0b, 0x0b, 0x81, 0x01, 0x02, 0x00, 0x41, 0x80, 0x08, 0x0b, 0x70, 0x5b, 0x62, 0x61, 0x73, 0x65, 0x36, 0x34, 0x5d, 0x20, 0x61, 0x73, 0x73, 0x65, 0x72, 0x74, 0x20, 0x66, 0x61, 0x69, 0x6c, 0x65, 0x64, 0x3a, 0x20, 0x62, 0x36, 0x34, 0x5f, 0x70, 0x6f, 0x73, 0x20, 0x3c, 0x3d, 0x20, 0x62, 0x36, 0x34, 0x5f, 0x6c, 0x65, 0x6e, 0x00, 0x5b, 0x62, 0x61, 0x73, 0x65, 0x36, 0x34, 0x5d, 0x20, 0x66, 0x69, 0x6e, 0x69, 0x73, 0x68, 0x65, 0x64, 0x00, 0x5b, 0x62, 0x61, 0x73, 0x65, 0x36, 0x34, 0x5d, 0x20, 0x72, 0x75, 0x6e, 0x6e, 0x69, 0x6e, 0x67, 0x20, 0x77, 0x69, 0x74, 0x68, 0x20, 0x6c, 0x65, 0x6e, 0x20, 0x3d, 0x20, 0x25, 0x7a, 0x75, 0x20, 0x66, 0x6f, 0x72, 0x20, 0x25, 0x64, 0x20, 0x69, 0x74, 0x65, 0x72, 0x61, 0x74, 0x69, 0x6f, 0x6e, 0x73, 0x0a, 0x00, 0x00, 0x41, 0xf0, 0x08, 0x0b, 0x04, 0x01, 0x00, 0x00, 0x00, 0x00, 0x8d, 0x01, 0x04, 0x6e, 0x61, 0x6d, 0x65, 0x01, 0x5f, 0x0a, 0x00, 0x06, 0x63, 0x61, 0x6c, 0x6c, 0x6f, 0x63, 0x01, 0x06, 0x6d, 0x61, 0x6c, 0x6c, 0x6f, 0x63, 0x02, 0x06, 0x70, 0x72, 0x69, 0x6e, 0x74, 0x66, 0x03, 0x0b, 0x62, 0x65, 0x6e, 0x63, 0x68, 0x5f, 0x73, 0x74, 0x61, 0x72, 0x74, 0x04, 0x04, 0x70, 0x75, 0x74, 0x73, 0x05, 0x06, 0x6d, 0x65, 0x6d, 0x73, 0x65, 0x74, 0x06, 0x09, 0x62, 0x65, 0x6e, 0x63, 0x68, 0x5f, 0x65, 0x6e, 0x64, 0x07, 0x04, 0x66, 0x72, 0x65, 0x65, 0x08, 0x0c, 0x62, 0x65, 0x6e, 0x63, 0x68, 0x5f, 0x62, 0x61, 0x73, 0x65, 0x36, 0x34, 0x09, 0x0a, 0x5f, 0x62, 0x6c, 0x61, 0x63, 0x6b, 0x5f, 0x62, 0x6f, 0x78, 0x07, 0x12, 0x01, 0x00, 0x0f, 0x5f, 0x5f, 0x73, 0x74, 0x61, 0x63, 0x6b, 0x5f, 0x70, 0x6f, 0x69, 0x6e, 0x74, 0x65, 0x72, 0x09, 0x11, 0x02, 0x00, 0x07, 0x2e, 0x72, 0x6f, 0x64, 0x61, 0x74, 0x61, 0x01, 0x05, 0x2e, 0x64, 0x61, 0x74, 0x61, 0x00, 0x26, 0x09, 0x70, 0x72, 0x6f, 0x64, 0x75, 0x63, 0x65, 0x72, 0x73, 0x01, 0x0c, 0x70, 0x72, 0x6f, 0x63, 0x65, 0x73, 0x73, 0x65, 0x64, 0x2d, 0x62, 0x79, 0x01, 0x05, 0x63, 0x6c, 0x61, 0x6e, 0x67, 0x06, 0x31, 0x37, 0x2e, 0x30, 0x2e, 0x36, 0x00, 0x2c, 0x0f, 0x74, 0x61, 0x72, 0x67, 0x65, 0x74, 0x5f, 0x66, 0x65, 0x61, 0x74, 0x75, 0x72, 0x65, 0x73, 0x02, 0x2b, 0x0f, 0x6d, 0x75, 0x74, 0x61, 0x62, 0x6c, 0x65, 0x2d, 0x67, 0x6c, 0x6f, 0x62, 0x61, 0x6c, 0x73, 0x2b, 0x08, 0x73, 0x69, 0x67, 0x6e, 0x2d, 0x65, 0x78, 0x74 };
```

## src/benchmark.c
~~~~c
#include "native_benchmark.h"
#include <string.h>
#include <stdlib.h>

// Implementation is not good because we initialize the wasm
// modules in bulk so it consumes more memory than necessary
// We should initialize the wasm modules one by one
// We need to refactor this code to have a more generalized interface
// eg: 
// ```c
// typedef void (*BenchmarkFunction)();

// typedef struct {
//     char* name;
//     BenchmarkFunction native_function; 
//     uint8_t* wasm_module;              
//     size_t wasm_module_size;           
// } Benchmark;
// ```
// We also need to avoid macros usage as it greatly dicreases the 
// readability of the code.

/* import native benchmarks main functions*/
extern int bench_ackermann();
extern int bench_base64();
extern int bench_fib2();
extern int bench_gimli();
extern int bench_matrix();
extern int bench_memmove();
extern int bench_random();
extern int bench_sieve();
extern int bench_heapsort();
extern int bench_nestedloop();
extern int bench_dummy();
extern int bench_socket_create();
extern int bench_socket_connect();
extern int bench_socket_bind();
extern int bench_socket_sendto();
extern int bench_socket_recvfrom();
extern int bench_fs_fopen();
extern int bench_fs_fwrite();
extern int bench_fs_fread();
extern int bench_fs_fseek();
extern int bench_fs_fclose();
extern int bench_fs_unlink();
extern int bench_fs_mkdir();
extern int bench_fs_rename();
extern int bench_fs_perf();

/* Global counter values */
static uint64_t native_bench_start_time = 0;
static uint64_t native_bench_end_time = 0;

/* function to ensure compatibility */
void bench_start(void){
    native_bench_start_time = k_cycle_get_32(); 
}

void bench_end(void){
    native_bench_end_time = k_cycle_get_32();
}

void reset_times(){
    native_bench_start_time = 0;
    native_bench_end_time = 0;
}

//-------------------------------------------------------------------------------------------//
void benchmark_banner(void){
#if BENCHMARK_FS    
    printk("\t - fs_fopen :              %s\n", BENCHMARK_FS_FOPEN ? "YES" : "NO");
    printk("\t - fs_fwrite :             %s\n", BENCHMARK_FS_FWRITE ? "YES" : "NO");
    printk("\t - fs_fread :              %s\n", BENCHMARK_FS_FREAD ? "YES" : "NO");
    printk("\t - fs_fseek :              %s\n", BENCHMARK_FS_FSEEK ? "YES" : "NO");
    printk("\t - fs_fclose :             %s\n", BENCHMARK_FS_FCLOSE ? "YES" : "NO");
    printk("\t - fs_unlink :             %s\n", BENCHMARK_FS_UNLINK ? "YES" : "NO");
    printk("\t - fs_mkdir :              %s\n", BENCHMARK_FS_MKDIR ? "YES" : "NO");
    printk("\t - fs_rename :             %s\n", BENCHMARK_FS_RENAME ? "YES" : "NO");
    printk("\t - fs_perf :               %s\n", BENCHMARK_FS_PERF ? "YES" : "NO");
#elif BENCHMARK_SOCKET
    printk("\t - socket_create :         %s\n", BENCHMARK_SOCKET_CREATE ? "YES" : "NO");
    printk("\t - socket_connect :        %s\n", BENCHMARK_SOCKET_CONNECT ? "YES" : "NO");
    printk("\t - socket_bind :           %s\n", BENCHMARK_SOCKET_BIND ? "YES" : "NO");
    printk("\t - socket_sendto :         %s\n", BENCHMARK_SOCKET_SENDTO ? "YES" : "NO");
    printk("\t - socket_recvfrom :       %s\n", BENCHMARK_SOCKET_RECVFROM ? "YES" : "NO");
#else
    printk("[INFO] Performing benchmarks:\n");
    printk("\t - ackermann :             %s\n", BENCHMARK_ACKERMANN ? "YES" : "NO");
    printk("\t - base64 :                %s\n", BENCHMARK_BASE64 ? "YES" : "NO");
    printk("\t - fib2 :                  %s\n", BENCHMARK_FIB2 ? "YES" : "NO");
    printk("\t - gimli :                 %s\n", BENCHMARK_GIMLI ? "YES" : "NO");
    printk("\t - matrix :                %s\n", BENCHMARK_MATRIX ? "YES" : "NO");
    printk("\t - memmove :               %s\n", BENCHMARK_MEMMOVE ? "YES" : "NO");
    printk("\t - random :                %s\n", BENCHMARK_RANDOM ? "YES" : "NO");
    printk("\t - sieve :                 %s\n", BENCHMARK_SIEVE ? "YES" : "NO");
    printk("\t - heapsort (unsupported): %s\n", BENCHMARK_HEAPSORT ? "YES" : "NO");
    printk("\t - nestedloop :            %s\n", BENCHMARK_NESTEDLOOP ? "YES" : "NO");
    printk("\t - dummy :                 %s\n", BENCHMARK_DUMMY ? "YES" : "NO");
#endif
}

//-------------------------------------------------------------------------------------------//
void call_bench_main(void){
#if BENCHMARK_ACKERMANN
    bench_ackermann();
    printk("[ackermann] elapsed: %llu ticks\n", (native_bench_end_time - native_bench_start_time));
    reset_times();
#endif

#if BENCHMARK_BASE64
    bench_base64();
    printk("[base64] elapsed: %llu ticks\n", (native_bench_end_time - native_bench_start_time));
    reset_times();
#endif

#if BENCHMARK_FIB2
    bench_fib2();
    printk("[fib2] elapsed: %llu ticks\n", (native_bench_end_time - native_bench_start_time));
    reset_times();
#endif

#if BENCHMARK_GIMLI
    bench_gimli();
    printk("[gimli] elapsed: %llu ticks\n", (native_bench_end_time - native_bench_start_time));
    reset_times();
#endif

#if BENCHMARK_MATRIX
    bench_matrix();
    printk("[matrix] elapsed: %llu ticks\n", (native_bench_end_time - native_bench_start_time));
    reset_times();
#endif

#if BENCHMARK_MEMMOVE
    bench_memmove();
    printk("[memmove] elapsed: %llu ticks\n", (native_bench_end_time - native_bench_start_time));
    reset_times();
#endif

#if BENCHMARK_RANDOM
    bench_random();
    printk("[random] elapsed: %llu ticks\n", (native_bench_end_time - native_bench_start_time));
    reset_times();
#endif

#if BENCHMARK_SIEVE
    bench_sieve();
    printk("[sieve] elapsed: %llu ticks\n", (native_bench_end_time - native_bench_start_time));
    reset_times();
#endif

#if BENCHMARK_HEAPSORT
    bench_heapsort();
    printk("[heapsort] elapsed: %llu ticks\n", (native_bench_end_time - native_bench_start_time));
    reset_times();
#endif

#if BENCHMARK_NESTEDLOOP
    bench_nestedloop();
    printk("[nestedloop] elapsed: %llu ticks\n", (native_bench_end_time - native_bench_start_time));
    reset_times();
#endif

#if BENCHMARK_DUMMY
    bench_dummy();
    printk("[dummy] elapsed: %llu ticks\n", (native_bench_end_time - native_bench_start_time));
    reset_times();
#endif

#if BENCHMARK_SOCKET_CREATE
    bench_socket_create();
    printk("[socket_create] elapsed: %llu ticks\n", (native_bench_end_time - native_bench_start_time));
    reset_times();
#endif

#if BENCHMARK_SOCKET_CONNECT
    bench_socket_connect();
    printk("[socket_connect] elapsed: %llu ticks\n", (native_bench_end_time - native_bench_start_time));
    reset_times();
#endif

#if BENCHMARK_SOCKET_BIND
    bench_socket_bind();
    printk("[socket_bind] elapsed: %llu ticks\n", (native_bench_end_time - native_bench_start_time));
    reset_times();
#endif

#if BENCHMARK_SOCKET_SENDTO
    bench_socket_sendto();
    printk("[socket_sendto] elapsed: %llu ticks\n", (native_bench_end_time - native_bench_start_time));
    reset_times();
#endif

#if BENCHMARK_SOCKET_RECVFROM
    bench_socket_recvfrom();
    printk("[socket_recvfrom] elapsed: %llu ticks\n", (native_bench_end_time - native_bench_start_time));
    reset_times();
#endif

#if BENCHMARK_FS_FOPEN
    bench_fs_fopen();
    printk("[fs_fopen] elapsed: %llu ticks\n", (native_bench_end_time - native_bench_start_time));
    reset_times();
#endif

#if BENCHMARK_FS_FWRITE
    bench_fs_fwrite();
    printk("[fs_fwrite] elapsed: %llu ticks\n", (native_bench_end_time - native_bench_start_time));
    reset_times();
#endif

#if BENCHMARK_FS_FREAD
    bench_fs_fread();
    printk("[fs_fread] elapsed: %llu ticks\n", (native_bench_end_time - native_bench_start_time));
    reset_times();
#endif

#if BENCHMARK_FS_FSEEK
    bench_fs_fseek();
    printk("[fs_fseek] elapsed: %llu ticks\n", (native_bench_end_time - native_bench_start_time));
    reset_times();
#endif

#if BENCHMARK_FS_FCLOSE
    bench_fs_fclose();
    printk("[fs_fclose] elapsed: %llu ticks\n", (native_bench_end_time - native_bench_start_time));
    reset_times();
#endif

#if BENCHMARK_FS_UNLINK
    bench_fs_unlink();
    printk("[fs_unlink] elapsed: %llu ticks\n", (native_bench_end_time - native_bench_start_time));
    reset_times();
#endif

#if BENCHMARK_FS_MKDIR
    bench_fs_mkdir();
    printk("[fs_mkdir] elapsed: %llu ticks\n", (native_bench_end_time - native_bench_start_time));
    reset_times();
#endif

#if BENCHMARK_FS_RENAME
    bench_fs_rename();
    printk("[fs_rename] elapsed: %llu ticks\n", (native_bench_end_time - native_bench_start_time));
    reset_times();
#endif

#if BENCHMARK_FS_PERF
    bench_fs_perf();
    printk("[fs_perf] elapsed: %llu ticks\n", (native_bench_end_time - native_bench_start_time));
    reset_times();
#endif
}

//-------------------------------------------------------------------------------------------//
#define MAX_BENCHMARKS 15

Benchmark benchmarks[MAX_BENCHMARKS];
int bench_nb = -1;

// mutex to protect the benchmark array
K_MUTEX_DEFINE(bench_array_mutex);

void allocate_benchmark(const char* func_name, const uint8_t* wasm_module, size_t wasm_module_size) {
    Benchmark *ptr = NULL;

    k_mutex_lock(&bench_array_mutex, K_FOREVER);
    for (int i = 0; i < MAX_BENCHMARKS; ++i) {
        // Find an unused entry
        if (benchmarks[i].func_name == NULL) { 
            ptr = &benchmarks[i];
            ptr->func_name = strdup(func_name);
            ptr->wasm_module = malloc(wasm_module_size);
            memcpy(ptr->wasm_module, wasm_module, wasm_module_size);
            ptr->wasm_module_size = wasm_module_size;
            bench_nb++;
            break;
        }
    }
    k_mutex_unlock(&bench_array_mutex);
}

void debugBenchmark(const Benchmark* benchmark) {
    printk("Function Name: %s\n", benchmark->func_name);
    printk("WASM Module: ");
    for (size_t i = 0; i < benchmark->wasm_module_size; ++i) {
        printk("%02X ", benchmark->wasm_module[i]);
    }
    printk("\n");
    printk("WASM Module Size: %zu bytes\n", benchmark->wasm_module_size);
}

void deallocate_benchmark(Benchmark* bench) {
    if (!bench) return;
    free(bench->func_name);
    free(bench->wasm_module);
    bench->func_name = NULL;
    bench->wasm_module = NULL;
}

void cleanup_benchmarks() {
    k_mutex_lock(&bench_array_mutex, K_FOREVER);
    for (int i = 0; i <= bench_nb; ++i) {
        deallocate_benchmark(&benchmarks[i]);
    }
    bench_nb = -1; // Reset the benchmark counter
    k_mutex_unlock(&bench_array_mutex);
}

/* Include all webassembly modules */
void initialize_benchmarks() {
    uint8_t *wasm_file_buf = NULL;
    size_t wasm_file_size = 0;

printk("[INFO] Initializing webassembly benchmarks\n");

#if BENCHMARK_ACKERMANN
#include "ackermann.h"
    wasm_file_buf = (uint8_t *)wasm_ackermann;
    wasm_file_size = sizeof(wasm_ackermann);

    allocate_benchmark("bench_ackermann", wasm_file_buf, wasm_file_size);
#endif

#if BENCHMARK_BASE64
#include "base64.h"
    wasm_file_buf = (uint8_t *)wasm_base64;
    wasm_file_size = sizeof(wasm_base64);

    allocate_benchmark("bench_base64", wasm_file_buf, wasm_file_size);
#endif

#if BENCHMARK_FIB2
#include "fib2.h"
    wasm_file_buf = (uint8_t *)wasm_fib2;
    wasm_file_size = sizeof(wasm_fib2);

    allocate_benchmark("bench_fib2", wasm_fib2, wasm_file_size);
#endif

#if BENCHMARK_GIMLI
#include "gimli.h"
    wasm_file_buf = (uint8_t *)wasm_gimli;
    wasm_file_size = sizeof(wasm_gimli);

    allocate_benchmark("bench_gimli", wasm_gimli, wasm_file_size);
#endif

#if BENCHMARK_MATRIX
#include "matrix.h"
    wasm_file_buf = (uint8_t *)wasm_matrix;
    wasm_file_size = sizeof(wasm_matrix);

    allocate_benchmark("bench_matrix", wasm_matrix, wasm_file_size);
#endif

#if BENCHMARK_MEMMOVE
#include "memmove.h"
    wasm_file_buf = (uint8_t *)wasm_memmove;
    wasm_file_size = sizeof(wasm_memmove);

    allocate_benchmark("bench_memmove", wasm_memmove, wasm_file_size);
#endif

#if BENCHMARK_RANDOM
#include "random.h"
    wasm_file_buf = (uint8_t *)wasm_random;
    wasm_file_size = sizeof(wasm_random);

    allocate_benchmark("bench_random", wasm_random, wasm_file_size);
#endif

#if BENCHMARK_SIEVE
#include "sieve.h"
    wasm_file_buf = (uint8_t *)wasm_sieve;
    wasm_file_size = sizeof(wasm_sieve);

    allocate_benchmark("bench_sieve", wasm_sieve, wasm_file_size);
#endif

#if BENCHMARK_HEAPSORT
#include "heapsort.h"
    wasm_file_buf = (uint8_t *)wasm_heapsort;
    wasm_file_size = sizeof(wasm_heapsort);

    allocate_benchmark("bench_heapsort", wasm_heapsort, wasm_file_size);
#endif

#if BENCHMARK_NESTEDLOOP
#include "nestedloop.h"
    wasm_file_buf = (uint8_t *)wasm_nestedloop;
    wasm_file_size = sizeof(wasm_nestedloop);

    allocate_benchmark("bench_nestedloop", wasm_nestedloop, wasm_file_size);
#endif

#if BENCHMARK_DUMMY
#include "dummy.h"
    wasm_file_buf = (uint8_t *)wasm_dummy;
    wasm_file_size = sizeof(wasm_dummy);
    allocate_benchmark("bench_dummy", wasm_dummy, wasm_file_size);
#endif

#if BENCHMARK_SOCKET_CREATE
#include "socket_create.h"
    wasm_file_buf = (uint8_t *)wasm_socket_create;
    wasm_file_size = sizeof(wasm_socket_create);
    allocate_benchmark("bench_socket_create", wasm_socket_create, wasm_file_size);
#endif

#if BENCHMARK_SOCKET_CONNECT
#include "socket_connect.h"
    wasm_file_buf = (uint8_t *)wasm_socket_connect;
    wasm_file_size = sizeof(wasm_socket_connect);
    allocate_benchmark("bench_socket_connect", wasm_socket_connect, wasm_file_size);
#endif

#if BENCHMARK_SOCKET_BIND
#include "socket_bind.h"
    wasm_file_buf = (uint8_t *)wasm_socket_bind;
    wasm_file_size = sizeof(wasm_socket_bind);
    allocate_benchmark("bench_socket_bind", wasm_socket_bind, wasm_file_size);
#endif

#if BENCHMARK_SOCKET_SENDTO
#include "socket_sendto.h"
    wasm_file_buf = (uint8_t *)wasm_socket_sendto;
    wasm_file_size = sizeof(wasm_socket_sendto);
    allocate_benchmark("bench_socket_sendto", wasm_socket_sendto, wasm_file_size);
#endif

#if BENCHMARK_SOCKET_RECVFROM
#include "socket_recvfrom.h"
    wasm_file_buf = (uint8_t *)wasm_socket_recvfrom;
    wasm_file_size = sizeof(wasm_socket_recvfrom);
    allocate_benchmark("bench_socket_recvfrom", wasm_socket_recvfrom, wasm_file_size);
#endif

#if BENCHMARK_FS_FOPEN
#include "fs_fopen.h"
    wasm_file_buf = (uint8_t *)wasm_fs_fopen;
    wasm_file_size = sizeof(wasm_fs_fopen);
    allocate_benchmark("bench_fs_fopen", wasm_fs_fopen, wasm_file_size);
#endif

#if BENCHMARK_FS_FWRITE
#include "fs_fwrite.h"
    wasm_file_buf = (uint8_t *)wasm_fs_fwrite;
    wasm_file_size = sizeof(wasm_fs_fwrite);
    allocate_benchmark("bench_fs_fwrite", wasm_fs_fwrite, wasm_file_size);
#endif

#if BENCHMARK_FS_FREAD
#include "fs_fread.h"
    wasm_file_buf = (uint8_t *)wasm_fs_fread;
    wasm_file_size = sizeof(wasm_fs_fread);
    allocate_benchmark("bench_fs_fread", wasm_fs_fread, wasm_file_size);
#endif

#if BENCHMARK_FS_FSEEK
#include "fs_fseek.h"
    wasm_file_buf = (uint8_t *)wasm_fs_fseek;
    wasm_file_size = sizeof(wasm_fs_fseek);
    allocate_benchmark("bench_fs_fseek", wasm_fs_fseek, wasm_file_size);
#endif

#if BENCHMARK_FS_FCLOSE
#include "fs_fclose.h"
    wasm_file_buf = (uint8_t *)wasm_fs_fclose;
    wasm_file_size = sizeof(wasm_fs_fclose);
    allocate_benchmark("bench_fs_fclose", wasm_fs_fclose, wasm_file_size);
#endif

#if BENCHMARK_FS_UNLINK
#include "fs_unlink.h"
    wasm_file_buf = (uint8_t *)wasm_fs_unlink;
    wasm_file_size = sizeof(wasm_fs_unlink);
    allocate_benchmark("bench_fs_unlink", wasm_fs_unlink, wasm_file_size);
#endif

#if BENCHMARK_FS_MKDIR
#include "fs_mkdir.h"
    wasm_file_buf = (uint8_t *)wasm_fs_mkdir;
    wasm_file_size = sizeof(wasm_fs_mkdir);
    allocate_benchmark("bench_fs_mkdir", wasm_fs_mkdir, wasm_file_size);
#endif

#if BENCHMARK_FS_RENAME
#include "fs_rename.h"
    wasm_file_buf = (uint8_t *)wasm_fs_rename;
    wasm_file_size = sizeof(wasm_fs_rename);
    allocate_benchmark("bench_fs_rename", wasm_fs_rename, wasm_file_size);
#endif

#if BENCHMARK_FS_PERF
#include "fs_perf.h"
    wasm_file_buf = (uint8_t *)wasm_fs_perf;
    wasm_file_size = sizeof(wasm_fs_perf);
    allocate_benchmark("bench_fs_perf", wasm_fs_perf, wasm_file_size);
#endif
}
~~~~

## src/config.h
```c
#ifndef CONFIG_H
#define CONFIG_H

#if ENABLE_BENCHMARK_ACKERMANN
    #define BENCHMARK_ACKERMANN 1
#else
    #define BENCHMARK_ACKERMANN 0
#endif

#if ENABLE_BENCHMARK_BASE64
    #define BENCHMARK_BASE64 1
#else
    #define BENCHMARK_BASE64 0
#endif

#if ENABLE_BENCHMARK_FIB2
    #define BENCHMARK_FIB2 1
#else
    #define BENCHMARK_FIB2 0
#endif

#if ENABLE_BENCHMARK_GIMLI
    #define BENCHMARK_GIMLI 1
#else
    #define BENCHMARK_GIMLI 0
#endif

#if ENABLE_BENCHMARK_MATRIX
    #define BENCHMARK_MATRIX 1
#else
    #define BENCHMARK_MATRIX 0
#endif

#if ENABLE_BENCHMARK_MEMMOVE
    #define BENCHMARK_MEMMOVE 1
#else
    #define BENCHMARK_MEMMOVE 0
#endif

#if ENABLE_BENCHMARK_RANDOM
    #define BENCHMARK_RANDOM 1
#else
    #define BENCHMARK_RANDOM 0
#endif

#if ENABLE_BENCHMARK_SIEVE
    #define BENCHMARK_SIEVE 1
#else
    #define BENCHMARK_SIEVE 0
#endif

#if ENABLE_BENCHMARK_HEAPSORT
    #define BENCHMARK_HEAPSORT 1
#else
    #define BENCHMARK_HEAPSORT 0
#endif

#if ENABLE_BENCHMARK_NESTEDLOOP
    #define BENCHMARK_NESTEDLOOP 1
#else
    #define BENCHMARK_NESTEDLOOP 0
#endif

#if ENABLE_BENCHMARK_DUMMY
    #define BENCHMARK_DUMMY 1
#else
    #define BENCHMARK_DUMMY 0
#endif

#if ENABLE_BENCHMARK_SOCKET_CREATE
    #define BENCHMARK_SOCKET_CREATE 1
#else
    #define BENCHMARK_SOCKET_CREATE 0
#endif

#if ENABLE_BENCHMARK_SOCKET_CONNECT
    #define BENCHMARK_SOCKET_CONNECT 1
#else
    #define BENCHMARK_SOCKET_CONNECT 0
#endif

#if ENABLE_BENCHMARK_SOCKET_BIND
    #define BENCHMARK_SOCKET_BIND 1
#else
    #define BENCHMARK_SOCKET_BIND 0
#endif

#if ENABLE_BENCHMARK_SOCKET_SENDTO
    #define BENCHMARK_SOCKET_SENDTO 1
#else
    #define BENCHMARK_SOCKET_SENDTO 0
#endif

#if ENABLE_BENCHMARK_SOCKET_RECVFROM
    #define BENCHMARK_SOCKET_RECVFROM 1
#else
    #define BENCHMARK_SOCKET_RECVFROM 0
#endif

#if ENABLE_BENCHMARK_FS_FOPEN
    #define BENCHMARK_FS_FOPEN 1
#else
    #define BENCHMARK_FS_FOPEN 0
#endif

#if ENABLE_BENCHMARK_FS_FWRITE
    #define BENCHMARK_FS_FWRITE 1
#else
    #define BENCHMARK_FS_FWRITE 0
#endif

#if ENABLE_BENCHMARK_FS_FREAD
    #define BENCHMARK_FS_FREAD 1
#else
    #define BENCHMARK_FS_FREAD 0
#endif

#if ENABLE_BENCHMARK_FS_FSEEK
    #define BENCHMARK_FS_FSEEK 1
#else
    #define BENCHMARK_FS_FSEEK 0
#endif

#if ENABLE_BENCHMARK_FS_FCLOSE
    #define BENCHMARK_FS_FCLOSE 1
#else
    #define BENCHMARK_FS_FCLOSE 0
#endif

#if ENABLE_BENCHMARK_FS_UNLINK
    #define BENCHMARK_FS_UNLINK 1
#else
    #define BENCHMARK_FS_UNLINK 0
#endif

#if ENABLE_BENCHMARK_FS_MKDIR
    #define BENCHMARK_FS_MKDIR 1
#else
    #define BENCHMARK_FS_MKDIR 0
#endif

#if ENABLE_BENCHMARK_FS_RENAME
    #define BENCHMARK_FS_RENAME 1
#else
    #define BENCHMARK_FS_RENAME 0
#endif

#if ENABLE_BENCHMARK_FS_PERF
    #define BENCHMARK_FS_PERF 1
#else
    #define BENCHMARK_FS_PERF 0
#endif


#define BENCHMARK_SOCKET (BENCHMARK_SOCKET_CREATE \
|| BENCHMARK_SOCKET_CONNECT \
|| BENCHMARK_SOCKET_BIND \
|| BENCHMARK_SOCKET_SENDTO \
|| BENCHMARK_SOCKET_RECVFROM)

#define BENCHMARK_FS (BENCHMARK_FS_FOPEN \
|| BENCHMARK_FS_FWRITE \
|| BENCHMARK_FS_FREAD \
|| BENCHMARK_FS_FSEEK \
|| BENCHMARK_FS_FCLOSE \
|| BENCHMARK_FS_UNLINK \
|| BENCHMARK_FS_MKDIR \
|| BENCHMARK_FS_RENAME \
|| BENCHMARK_FS_PERF)

#endif /* CONFIG_H */
```

## src/dummy.h
```c
unsigned char __aligned(4) wasm_dummy[] = { 0x00, 0x61, 0x73, 0x6d, 0x01, 0x00, 0x00, 0x00, 0x01, 0x08, 0x02, 0x60, 0x00, 0x00, 0x60, 0x00, 0x01, 0x7f, 0x02, 0x23, 0x02, 0x03, 0x65, 0x6e, 0x76, 0x0b, 0x62, 0x65, 0x6e, 0x63, 0x68, 0x5f, 0x73, 0x74, 0x61, 0x72, 0x74, 0x00, 0x00, 0x03, 0x65, 0x6e, 0x76, 0x09, 0x62, 0x65, 0x6e, 0x63, 0x68, 0x5f, 0x65, 0x6e, 0x64, 0x00, 0x00, 0x03, 0x02, 0x01, 0x01, 0x05, 0x03, 0x01, 0x00, 0x01, 0x06, 0x15, 0x03, 0x7f, 0x01, 0x41, 0x80, 0xc8, 0x00, 0x0b, 0x7f, 0x00, 0x41, 0x80, 0x08, 0x0b, 0x7f, 0x00, 0x41, 0x80, 0xc8, 0x00, 0x0b, 0x07, 0x33, 0x04, 0x06, 0x6d, 0x65, 0x6d, 0x6f, 0x72, 0x79, 0x02, 0x00, 0x0b, 0x62, 0x65, 0x6e, 0x63, 0x68, 0x5f, 0x64, 0x75, 0x6d, 0x6d, 0x79, 0x00, 0x02, 0x0a, 0x5f, 0x5f, 0x64, 0x61, 0x74, 0x61, 0x5f, 0x65, 0x6e, 0x64, 0x03, 0x01, 0x0b, 0x5f, 0x5f, 0x68, 0x65, 0x61, 0x70, 0x5f, 0x62, 0x61, 0x73, 0x65, 0x03, 0x02, 0x0a, 0x12, 0x01, 0x10, 0x00, 0x10, 0x80, 0x80, 0x80, 0x80, 0x00, 0x10, 0x81, 0x80, 0x80, 0x80, 0x00, 0x41, 0x00, 0x0b, 0x00, 0x41, 0x04, 0x6e, 0x61, 0x6d, 0x65, 0x01, 0x26, 0x03, 0x00, 0x0b, 0x62, 0x65, 0x6e, 0x63, 0x68, 0x5f, 0x73, 0x74, 0x61, 0x72, 0x74, 0x01, 0x09, 0x62, 0x65, 0x6e, 0x63, 0x68, 0x5f, 0x65, 0x6e, 0x64, 0x02, 0x0b, 0x62, 0x65, 0x6e, 0x63, 0x68, 0x5f, 0x64, 0x75, 0x6d, 0x6d, 0x79, 0x07, 0x12, 0x01, 0x00, 0x0f, 0x5f, 0x5f, 0x73, 0x74, 0x61, 0x63, 0x6b, 0x5f, 0x70, 0x6f, 0x69, 0x6e, 0x74, 0x65, 0x72, 0x00, 0x26, 0x09, 0x70, 0x72, 0x6f, 0x64, 0x75, 0x63, 0x65, 0x72, 0x73, 0x01, 0x0c, 0x70, 0x72, 0x6f, 0x63, 0x65, 0x73, 0x73, 0x65, 0x64, 0x2d, 0x62, 0x79, 0x01, 0x05, 0x63, 0x6c, 0x61, 0x6e, 0x67, 0x06, 0x31, 0x37, 0x2e, 0x30, 0x2e, 0x36, 0x00, 0x2c, 0x0f, 0x74, 0x61, 0x72, 0x67, 0x65, 0x74, 0x5f, 0x66, 0x65, 0x61, 0x74, 0x75, 0x72, 0x65, 0x73, 0x02, 0x2b, 0x0f, 0x6d, 0x75, 0x74, 0x61, 0x62, 0x6c, 0x65, 0x2d, 0x67, 0x6c, 0x6f, 0x62, 0x61, 0x6c, 0x73, 0x2b, 0x08, 0x73, 0x69, 0x67, 0x6e, 0x2d, 0x65, 0x78, 0x74 };
```

## src/native_benchmark.h
```c
#ifndef BENCHMARK_H
#define BENCHMARK_H 

#include <zephyr/kernel.h>
#include "config.h" 

/* types and functions definitions */
typedef struct {
    char* func_name;            // Name of the function to run
    const uint8_t *wasm_module;   // Pointer to the WASM module array
    size_t wasm_module_size;    // Size of the WASM module array
} Benchmark;

void call_bench_main(void);
void initialize_benchmarks();
void cleanup_benchmarks();
void deallocate_benchmark(Benchmark* bench);
void benchmark_banner(void);

#endif /* BENCHMARK_H */
```

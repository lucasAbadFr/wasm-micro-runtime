## CMakeLists.txt
```
# Copyright (C) 2019 Intel Corporation.  All rights reserved.
# SPDX-License-Identifier: Apache-2.0 WITH LLVM-exception

cmake_minimum_required(VERSION 3.8.2)

find_package(Zephyr REQUIRED HINTS $ENV{ZEPHYR_BASE})
project(wamr)

enable_language (ASM)

set (WAMR_BUILD_PLATFORM "zephyr")


#==============================================================================
# WAMR Definitions
#------------------------------------------------------------------------------
set (WAMR_BUILD_TARGET "THUMB")
set (WAMR_BUILD_INTERP 1)
set (WAMR_BUILD_AOT 0)
set (WAMR_BUILD_LIBC_BUILTIN 1) # printf
set (WAMR_BUILD_LIBC_WASI 1)
set (WAMR_BUILD_LIB_PTHREAD 0)
set (WAMR_BUILD_GLOBAL_HEAP_POOL 1)
set (WAMR_BUILD_GLOBAL_HEAP_SIZE 131072) # 128 KB

# Experimental:
set (WAMR_BUILD_WASI_EPHEMERAL_NN 1)
set (WAMR_BUILD_WASI_NN_TFLM 1)         # New definition


# Strangely the modules seem to use ref types. 
#
# Serial terminal output:
#
#     Failed to load module: WASM module load failed: zero byte expected.
#     The module uses reference types feature which is disabled in the runtime
#
#  
set (WAMR_BUILD_REF_TYPES 1)


# WAMR_BUILD_WASI_NN_ENABLE_GPU - default to disable if not set


#==============================================================================
# Environment dependencies
#------------------------------------------------------------------------------

# Check if WAMR_ROOT_DIR is set 
if(DEFINED ENV{WAMR_ROOT_DIR})
  set(WAMR_ROOT_DIR $ENV{WAMR_ROOT_DIR})
else()
  message(FATAL_ERROR "'WAMR_ROOT_DIR' need to be specified")
endif()
message("wasi-sdk was found at ${WAMR_ROOT_DIR}")

# Check if WASI_SDK_PATH is set 
if(NOT $ENV{WASI_SDK_PATH} STREQUAL "")
  set(WASI_SDK_PATH $ENV{WASI_SDK_PATH})
else()
  find_program(WASM_C_COMPILER clang /opt/wasi-sdk/bin NO_DEFAULT_PATH)
  if(NOT WASM_C_COMPILER)
    message(FATAL_ERROR "'wasi-sdk' not found, please ensure wasi-sdk is installed.\
                         You can download and install it from\
                         https://github.com/WebAssembly/wasi-sdk/releases")
  else()
    set(WASI_SDK_PATH /opt/wasi-sdk)
  endif()
endif()
message("wasi-sdk was found at ${WASI_SDK_PATH}")

# Check if WAMR_APP_FRAMEWORK_DIR is set
if (DEFINED ENV{WAMR_APP_FRAMEWORK_DIR})
  set(WAMR_APP_FRAMEWORK_DIR $ENV{WAMR_APP_FRAMEWORK_DIR})
else()
  message(FATAL_ERROR "'wamr-app-framework' not found, please ensure they are installed.\
                       You can download and install them from\
                       https://github.com/bytecodealliance/wamr-app-framework")
endif()
message("wamr-app-framework was found at ${WAMR_APP_FRAMEWORK_DIR}")

# set the WAMR_SDK_DIR with the path specified in the environment variable
set(WAMR_SDK_DIR
    ${WAMR_APP_FRAMEWORK_DIR}/wamr-sdk
)

# set the WAMR_LIBC_BUILTIN_DIR
set(WAMR_LIBC_BUILTIN_DIR
    ${WAMR_SDK_DIR}/wamr-sdk/app/libc-builtin-sysroot
)

# set the WAMR_SDK_PACKAGE_OUT_DIR 
set(WAMR_SDK_PACKAGE_OUT_DIR
    ${CMAKE_CURRENT_BINARY_DIR}/wamr-sdk/app-sdk/wamr-app-framework
)


#==============================================================================
# CMake scripts dependencies
#------------------------------------------------------------------------------
include (${WAMR_ROOT_DIR}/build-scripts/runtime_lib.cmake)
include (${WAMR_ROOT_DIR}/core/iwasm/libraries/wasi-nn/cmake/wasi_nn.cmake)



#==============================================================================
# Application Target
#------------------------------------------------------------------------------

# Build the WAMR runtime 
target_sources(app PRIVATE
               ${WAMR_RUNTIME_LIB_SOURCE}
               ${WASI_NN_SOURCES_ALL}
               src/main.c)

# Link libraries like in samples.
set(WASI_LIBM  "${WASI_SDK_PATH}/share/wasi-sysroot/lib/wasm32-wasi/libm.a")
set(WASI_LIBDL "${WASI_SDK_PATH}/share/wasi-sysroot/lib/wasm32-wasi/libdl.a")

target_link_libraries(app PUBLIC ${WASI_LIBM} ${WASI_LIBDL})
```

## prj.conf
```kconfig
# Copyright (C) 2019 Intel Corporation.  All rights reserved.
# SPDX-License-Identifier: Apache-2.0 WITH LLVM-exception


#==============================================================================
# Sample Application Configuration - Default
#------------------------------------------------------------------------------
# 
#### Description:
#
#    This configuration provides a typical setup with LOG and printk enabled.
#    The main stack size is increased to 8 KB (could be refined later).
#
#### Note:
#
#    This sample is not optimized for production use — it serves as a proof of
#    concept demonstrating the coexistence of Zephyr, WAMR, and TFLM.
#
CONFIG_PRINTK=y
CONFIG_LOG=y
CONFIG_MAIN_STACK_SIZE=16384
CONFIG_LOG_MODE_IMMEDIATE=y 
CONFIG_POSIX_API=n


#==============================================================================
# WAMR_BUILD_LIBC_WASI - Dependencies 
#------------------------------------------------------------------------------
#
#### Description:
#
#    `WAMR_BUILD_LIBC_WASI` is mainly used on higher-level platforms (Linux,
#    Windows). On Zephyr, enabling this flag requires pulling in both the
#    network and file system stacks along with their dependencies.
#
#    Ideally, a modular RTOS approach would allow selecting only the necessary
#    components, improving size and clarity.
#

# File System Stack
CONFIG_FILE_SYSTEM=y
CONFIG_FILE_SYSTEM_LITTLEFS=y

# Network Stack
CONFIG_NETWORKING=y
CONFIG_NET_IPV4=y
CONFIG_NET_IPV6=y
CONFIG_NET_TCP=y
CONFIG_NET_SOCKETS=y

# File System Stack - Dep
# 
#  LittleFS requires:
#     - CONFIG_FS_LITTLEFS_BLK_DEV 
#     - CONFIG_FS_LITTLEFS_FMP_DEV
# However, enabling CONFIG_FS_LITTLEFS_BLK_DEV together with CONFIG_FLASH
# currently leads to unresolved symbols.
CONFIG_FLASH=y
CONFIG_FLASH_MAP=y

# Network Stack - Dep
CONFIG_TEST_RANDOM_GENERATOR=y       # `sys_rand_get` (unresolved symbol)


#==============================================================================
# TensorFlow Lite Micro - Dependencies
#------------------------------------------------------------------------------
#
#### Description:
#
#    Inspired by Zephyr’s TFLM samples. Some additional dependencies were added
#    due to compilation issues encountered when integrating WAMR.
#
CONFIG_CPP=y
CONFIG_STD_CPP17=y                   # `std::consitional_t`, Type, etc..
CONFIG_REQUIRES_FULL_LIBC=y
CONFIG_TENSORFLOW_LITE_MICRO=y


# Investigate Later:
# CONFIG_TENSORFLOW_LITE_MICRO_CMSIS_NN_KERNELS
```

## src/main.c
```c
/*
 * Copyright (C) 2019 Intel Corporation.  All rights reserved.
 * SPDX-License-Identifier: Apache-2.0 WITH LLVM-exception
 */

// #include <autoconf.h>

#include <stdlib.h>
#include <string.h>
#include "bh_platform.h"
#include "bh_assert.h"
#include "bh_log.h"
#include "wasm_export.h"

#include <zephyr/kernel.h>
#include <zephyr/device.h>
#include <zephyr/devicetree.h>
#include <zephyr/net/net_ip.h>
#include <zephyr/net/socket.h>
#include <zephyr/net/http/client.h>

/* Hello World WASM module */
#include "wasi_nn_module.h"

#define CONFIG_HEAP_MEM_POOL_SIZE WASM_GLOBAL_HEAP_SIZE
#define CONFIG_APP_STACK_SIZE 8192
#define CONFIG_APP_HEAP_SIZE  8192

static char global_heap_buf[CONFIG_HEAP_MEM_POOL_SIZE] = { 0 };

LOG_MODULE_REGISTER(main);

int
main(void)
{
    wasm_module_inst_t wasm_module_inst = NULL;
    wasm_module_t wasm_module           = NULL;
    uint8 *wasm_file_buf                = NULL;
    uint32 wasm_file_size               = 0;
    RuntimeInitArgs init_args;
    char error_buf[128];
    const char *exception;
    int start, end;
    
    start = k_uptime_get_32();
    
    memset(&init_args, 0, sizeof(RuntimeInitArgs));

#if WASM_ENABLE_GLOBAL_HEAP_POOL != 0
    init_args.mem_alloc_type                  = Alloc_With_Pool;
    init_args.mem_alloc_option.pool.heap_buf  = global_heap_buf;
    init_args.mem_alloc_option.pool.heap_size = sizeof(global_heap_buf);

    LOG_INF("global heap size: %d\n", sizeof(global_heap_buf));
#else
#error "memory allocation scheme is not defined."
#endif

    /* initialize runtime environment */
    if (!wasm_runtime_full_init(&init_args)) {
        LOG_ERR("Init runtime environment failed.\n");
        return 0;
    }


    /* load WASM byte buffer from byte buffer of include file */
    wasm_file_buf  = (uint8 *)wasi_nn_module_wasm;
    wasm_file_size = wasi_nn_module_wasm_len;
    LOG_INF("Wasm file size: %d\n", wasm_file_size);

    /* load WASM module */
    wasm_module = wasm_runtime_load(wasm_file_buf, wasm_file_size,
                                    error_buf, sizeof(error_buf));
    if (!wasm_module) {
        LOG_ERR("Failed to load module: %s\n", error_buf);
        goto cleanup;
    }

    /* Set the WASI context */
#if WASM_ENABLE_LIBC_WASI != 0
// #define ADDRESS_POOL_SIZE 1
//     const char *addr_pool[ADDRESS_POOL_SIZE] = {
//         "192.0.2.10/24",
//     };
//     /* No dir list => No file system
//      * dir_cont = 0
//      * No mapped dir list => No file system
//      * map_dir_cont = 0
//      * No environment variables
//      * env_count = 0
//      * No command line arguments
//      * argv  0
//      */
//     wasm_runtime_set_wasi_args(wasm_module, NULL, 0, NULL, 0, NULL, 0, NULL, 0);
//     wasm_runtime_set_wasi_addr_pool(wasm_module, addr_pool, ADDRESS_POOL_SIZE);
//     wasm_runtime_set_wasi_ns_lookup_pool(wasm_module, NULL, 0);
#endif

    /* instantiate the module */
    wasm_module_inst = wasm_runtime_instantiate(wasm_module, CONFIG_APP_STACK_SIZE,
                                    CONFIG_APP_HEAP_SIZE, error_buf, sizeof(error_buf));
    if (!wasm_module_inst) {
        LOG_ERR("Failed to instantiate module: %s\n", error_buf);
        goto unload;
    }

    /*
     * Lookup for usual function name
     *
     * TODO: remove later, it is strange to export only main. 
     */
    wasm_function_inst_t main_args_inst = NULL;
    wasm_function_inst_t start_inst     = NULL;
    wasm_function_inst_t main_inst      = NULL;

    start_inst      = wasm_runtime_lookup_function(wasm_module_inst, "_start");
    main_inst       = wasm_runtime_lookup_function(wasm_module_inst, "main"); 
    main_args_inst  = wasm_runtime_lookup_function(wasm_module_inst, "__main_argc_argv");

    if ((start_inst == NULL) && (main_inst == NULL) && (main_args_inst == NULL)) {
        LOG_ERR("Failed to lookup function main\n");
        return -1;
    }
    
    /* invoke the main function */
    wasm_application_execute_main(wasm_module_inst, 0, NULL);
    
    LOG_INF("main executed\n");

    if ((exception = wasm_runtime_get_exception(wasm_module_inst)))
        LOG_INF("%s\n", exception);

    int rc = wasm_runtime_get_wasi_exit_code(wasm_module_inst);
    LOG_INF("wasi exit code: %d\n", rc);

    /* destroy the module instance */
    wasm_runtime_deinstantiate(wasm_module_inst);

unload:
    /* unload the module */
    wasm_runtime_unload(wasm_module);

cleanup:
    /* destroy runtime environment */
    wasm_runtime_destroy();

    end = k_uptime_get_32();

    LOG_INF("elapsed: %dms\n", (end - start));

    return 0;
}
```

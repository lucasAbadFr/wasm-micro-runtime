## CMakeLists.txt
```
# # Copyright (c) 2021 Intel Corporation
# # SPDX-Licensedentifier: Apache-2.0

cmake_minimum_required(VERSION 3.8.2)

find_package(Zephyr REQUIRED HINTS $ENV{ZEPHYR_BASE})

project(wasm_app_manager)

set (WAMR_BUILD_PLATFORM "zephyr")

if (NOT DEFINED WAMR_BUILD_TARGET)
  set (WAMR_BUILD_TARGET "X86_32")
endif ()

if (NOT DEFINED WAMR_BUILD_INTERP)
  # Enable Interpreter by default
  set (WAMR_BUILD_INTERP 1)
endif ()

if (NOT DEFINED WAMR_BUILD_AOT)
  # Enable AOT by default.
  set (WAMR_BUILD_AOT 1)
endif ()

if (NOT DEFINED WAMR_BUILD_LIBC_BUILTIN)
  # Enable libc builtin support by default
  set (WAMR_BUILD_LIBC_BUILTIN 1)
endif ()

if (NOT DEFINED WAMR_BUILD_LIBC_WASI)
  # Disable libc wasi support by default
  set (WAMR_BUILD_LIBC_WASI 0)
endif ()

if (WAMR_BUILD_TARGET STREQUAL "RISCV64_LP64" OR WAMR_BUILD_TARGET STREQUAL "RISCV32_ILP32")
  set (WAMR_BUILD_FAST_INTERP 1)
endif ()

# Override the global heap usage
if (NOT DEFINED WAMR_BUILD_GLOBAL_HEAP_POOL)
  set (WAMR_BUILD_GLOBAL_HEAP_POOL 1)
endif ()

# Override the global heap size for small devices
if (NOT DEFINED WAMR_BUILD_GLOBAL_HEAP_SIZE)
  set (WAMR_BUILD_GLOBAL_HEAP_SIZE 131072) # 128 KB
endif ()

if (NOT DEFINED WAMR_BUILD_APP_FRAMEWORK)
  set (WAMR_BUILD_APP_FRAMEWORK 0)
endif()
# WAMR Configuration:

# Environment variables check: 

# Check if WASI_SDK_PATH and is set 
if(NOT $ENV{WASI_SDK_PATH} STREQUAL "")
  set(WASI_SDK_PATH $ENV{WASI_SDK_PATH})
else()
  find_program(WASM_C_COMPILER clang /opt/wasi-sdk/bin NO_DEFAULT_PATH)
  if(NOT WASM_C_COMPILER)
    message(FATAL_ERROR "'wasi-sdk' not found, please ensure wasi-sdk is installed.\
                         You can download and install it from\
                         https://github.com/WebAssembly/wasi-sdk/releases")
  else()
    set(WASI_SDK_PATH /opt/wasi-sdk)
  endif()
endif()

message("wasi-sdk was found at ${WASI_SDK_PATH}")

# Check if WAMR_ROOT_DIR and is set 
if(DEFINED ENV{WAMR_ROOT_DIR})
  set(WAMR_ROOT_DIR $ENV{WAMR_ROOT_DIR})
else()
  message(FATAL_ERROR "'WAMR_ROOT_DIR' need to be specified")
endif()

message("wamr was found at ${WAMR_ROOT_DIR}")

# Check if WAMR_APP_FRAMEWORK_DIR is set
if (DEFINED ENV{WAMR_APP_FRAMEWORK_DIR})
  set(WAMR_APP_FRAMEWORK_DIR $ENV{WAMR_APP_FRAMEWORK_DIR})
else()
  message(FATAL_ERROR "'wamr-app-framework' not found, please ensure they are installed.\
                       You can download and install them from\
                       https://github.com/bytecodealliance/wamr-app-framework")
endif()

message("wamr-app-framework was found at ${WAMR_APP_FRAMEWORK_DIR}")

# set the WAMR_SDK_DIR with the path specified in the environment variable
set(WAMR_SDK_DIR
    ${WAMR_APP_FRAMEWORK_DIR}/wamr-sdk
)

# set the WAMR_LIBC_BUILTIN_DIR with the path specified in the environment variable
set(WAMR_LIBC_BUILTIN_DIR
    ${WAMR_SDK_DIR}/wamr-sdk/app/libc-builtin-sysroot
)

# set the WAMR_SDK_PACKAGE_OUT_DIR
set(WAMR_SDK_PACKAGE_OUT_DIR
    ${CMAKE_CURRENT_BINARY_DIR}/wamr-sdk/app-sdk/wamr-app-framework
)

zephyr_compile_definitions_ifdef(WAMR_BUILD_APP_FRAMEWORK
    WASM_ENABLE_APP_FRAMEWORK=1
    WASM_ENABLE_BASE_LIB=1
    attr_container_printf=os_printf
)

zephyr_include_directories_ifdef(WAMR_BUILD_APP_FRAMEWORK
    ${WAMR_APP_FRAMEWORK_DIR}/app-framework/app-native-shared
    ${WAMR_APP_FRAMEWORK_DIR}/app-framework/base/native
    ${WAMR_ROOT_DIR}/core/shared/coap/er-coap
    ${WAMR_ROOT_DIR}/core/shared/coap/extension
    #${WAMR_APP_FRAMEWORK_DIR}/app-mgr/app-manager
    ${WAMR_APP_FRAMEWORK_DIR}/app-mgr/app-mgr-shared
)

zephyr_library_sources_ifdef(WAMR_BUILD_APP_FRAMEWORK
    ${WAMR_APP_FRAMEWORK_DIR}/app-mgr/app-manager/app_manager.c
    ${WAMR_APP_FRAMEWORK_DIR}/app-mgr/app-manager/app_manager_host.c
    ${WAMR_APP_FRAMEWORK_DIR}/app-mgr/app-manager/ble_msg.c
    ${WAMR_APP_FRAMEWORK_DIR}/app-mgr/app-manager/event.c
    ${WAMR_APP_FRAMEWORK_DIR}/app-mgr/app-manager/message.c
    ${WAMR_APP_FRAMEWORK_DIR}/app-mgr/app-manager/module_utils.c
    ${WAMR_APP_FRAMEWORK_DIR}/app-mgr/app-manager/module_wasm_app.c
    ${WAMR_APP_FRAMEWORK_DIR}/app-mgr/app-manager/module_wasm_lib.c
    ${WAMR_APP_FRAMEWORK_DIR}/app-mgr/app-manager/resource_reg.c
    ${WAMR_APP_FRAMEWORK_DIR}/app-mgr/app-manager/watchdog.c
    ${WAMR_APP_FRAMEWORK_DIR}/app-framework/app_ext_lib_export.c
    ${WAMR_APP_FRAMEWORK_DIR}/app-framework/app-native-shared/attr_container.c
    ${WAMR_APP_FRAMEWORK_DIR}/app-framework/app-native-shared/restful_utils.c
    ${WAMR_APP_FRAMEWORK_DIR}/app-framework/base/native/base_lib_export.c
    ${WAMR_APP_FRAMEWORK_DIR}/app-framework/base/native/request_response.c
    ${WAMR_APP_FRAMEWORK_DIR}/app-framework/base/native/timer_wrapper.c
)

add_dependencies(app host-tool wamr-sdk)

# temp 
set(ZEPHYR_BASE $ENV{ZEPHYR_BASE})
include (${ZEPHYR_BASE}/samples/subsys/usb/common/common.cmake)
# ~temp
include (${WAMR_ROOT_DIR}/build-scripts/runtime_lib.cmake)

#target_link_libraries(app PRIVATE ${CMAKE_CURRENT_BINARY_DIR}/app/libapp.a)
target_sources(app PRIVATE ${WAMR_RUNTIME_LIB_SOURCE} src/main.c)

include(ExternalProject)

ExternalProject_Add(wamr-sdk
  SOURCE_DIR
    ${WAMR_SDK_DIR}/app
  BINARY_DIR
    ${CMAKE_CURRENT_BINARY_DIR}/wamr-sdk
  CONFIGURE_COMMAND
    ${CMAKE_COMMAND} -G${CMAKE_GENERATOR} ${WAMR_SDK_DIR}/app
      -DWAMR_BUILD_SDK_PROFILE=simple
      -DCONFIG_PATH=${CMAKE_CURRENT_SOURCE_DIR}/wamr_sdk_config.cmake
      -DCMAKE_TOOLCHAIN_FILE=${WAMR_SDK_DIR}/app/wamr_toolchain.cmake
      -DOUT_DIR=${CMAKE_CURRENT_BINARY_DIR}/wamr-sdk
      -DWASI_SDK_DIR=${WASI_SDK_PATH}
  BUILD_COMMAND
    ${CMAKE_COMMAND} --build .
  INSTALL_COMMAND
    ""
  BUILD_BYPRODUCTS
    ${WAMR_SDK_PACKAGE_OUT_DIR}/include/wasm_app.h
    ${WAMR_SDK_PACKAGE_OUT_DIR}/lib/libapp_framework.a
  USES_TERMINAL
)

set(WASM_APPS
    timer
    request_handler
    request_sender
    event_publisher
    event_subscriber
    http_get
)

foreach(WASM_APP ${WASM_APPS})
  add_custom_target(${WASM_APP} ALL
    COMMENT
      "Building ${WASM_APP}.wasm .."
    COMMAND
      ${CMAKE_COMMAND} -E make_directory ${CMAKE_CURRENT_BINARY_DIR}/wasm-apps
    COMMAND
      ${WASI_SDK_PATH}/bin/clang -O3
        -I${WAMR_LIBC_BUILTIN_DIR}/include
        -I${WAMR_SDK_PACKAGE_OUT_DIR}/include
        -I/usr/include/
        -L${WAMR_SDK_PACKAGE_OUT_DIR}/lib
        -lapp_framework
        -z stack-size=8192 -Wl,--initial-memory=65536
        -Wl,--no-entry -nostdlib -Wl,--allow-undefined
        -Wl,--export=__heap_base,--export=__data_end
        -Wl,--export=on_init -Wl,--export=on_destroy
        -Wl,--export=on_request -Wl,--export=on_response
        -Wl,--export=on_sensor_event -Wl,--export=on_timer_callback
        -Wl,--export=on_connection_data
        -o ${CMAKE_CURRENT_BINARY_DIR}/wasm-apps/${WASM_APP}.wasm
        ${CMAKE_CURRENT_SOURCE_DIR}/wasm-apps/${WASM_APP}.c
    DEPENDS
      wamr-sdk
      ${CMAKE_CURRENT_SOURCE_DIR}/wasm-apps/${WASM_APP}.c
    BYPRODUCTS
      ${CMAKE_CURRENT_BINARY_DIR}/wasm-apps/${WASM_APP}.wasm
    USES_TERMINAL
  )
endforeach()

ExternalProject_Add(host-tool
  SOURCE_DIR
    ${WAMR_APP_FRAMEWORK_DIR}/test-tools/host-tool
  BINARY_DIR
    ${CMAKE_CURRENT_BINARY_DIR}/host-tool-build
  CONFIGURE_COMMAND
    ${CMAKE_COMMAND} -G${CMAKE_GENERATOR} ${WAMR_APP_FRAMEWORK_DIR}/test-tools/host-tool
  BUILD_COMMAND
    ${CMAKE_COMMAND} --build .
  INSTALL_COMMAND
    ${CMAKE_COMMAND} -E copy
      ${CMAKE_CURRENT_BINARY_DIR}/host-tool-build/host_tool
      ${CMAKE_CURRENT_BINARY_DIR}/host_tool
  BUILD_BYPRODUCTS
    ${CMAKE_CURRENT_BINARY_DIR}/host_tool
  USES_TERMINAL
)
```

## prj.conf
```kconfig
CONFIG_SPI=y
CONFIG_SPI_STM32=y
CONFIG_PRINTK=y
CONFIG_LOG=y
CONFIG_UART_INTERRUPT_DRIVEN=y
CONFIG_STACK_SENTINEL=y
CONFIG_MAIN_STACK_SIZE=2048

# usb related
CONFIG_USB_DEVICE_STACK=y
CONFIG_USB_DEVICE_PRODUCT="Zephyr USB console sample"
CONFIG_USB_DEVICE_PID=0x0004
CONFIG_USB_DEVICE_INITIALIZE_AT_BOOT=n

CONFIG_SERIAL=y
CONFIG_CONSOLE=y
CONFIG_UART_CONSOLE=y
CONFIG_UART_LINE_CTRL=y
```

## usbd_next_prj.conf
```kconfig
CONFIG_USB_DEVICE_STACK_NEXT=y

CONFIG_STDOUT_CONSOLE=y
CONFIG_SERIAL=y
CONFIG_UART_LINE_CTRL=y
CONFIG_USBD_CDC_ACM_CLASS=y

CONFIG_LOG=y
CONFIG_USBD_LOG_LEVEL_WRN=y
CONFIG_UDC_DRIVER_LOG_LEVEL_WRN=y

CONFIG_SAMPLE_USBD_PID=0x0004
CONFIG_SAMPLE_USBD_PRODUCT="USBD console sample"
```

## src/main.c
```c
/*
 * Copyright (c) 2020 Intel Corporation
 *
 * SPDX-License-Identifier: Apache-2.0
 */

#include <stdlib.h>
#include <string.h>

#include <autoconf.h>
#include <version.h>

#if KERNEL_VERSION_NUMBER < 0x030200 /* version 3.2.0 */
#include <zephyr.h>
#include <drivers/uart.h>
#include <device.h>
#else /* else of KERNEL_VERSION_NUMBER < 0x030200 */
#include <zephyr/kernel.h>
#include <zephyr/drivers/uart.h>
#include <zephyr/device.h>

#include <sample_usbd.h>

#include <zephyr/usb/usb_device.h>
#include <zephyr/usb/usbd.h>


#endif /* end of KERNEL_VERSION_NUMBER < 0x030200 */

#include "bh_platform.h"
#include "wasm_export.h"
#include "app_manager_export.h"
#include "runtime_lib.h"
#include "board_config.h"

extern void init_sensor_framework(void);
extern void exit_sensor_framework(void);
extern int aee_host_msg_callback(void *msg, uint16_t msg_len);

static int uart_char_cnt;

const struct device *uart_dev;

uint32_t dtr = 0;

// needed to map uart to usb 
#if defined(CONFIG_USB_DEVICE_STACK_NEXT)
static struct usbd_contex *sample_usbd;

static int enable_usb_device_next(void)
{
	int err;

	sample_usbd = sample_usbd_init_device(NULL);
	if (sample_usbd == NULL) {
		return -ENODEV;
	}

	err = usbd_enable(sample_usbd);
	if (err) {
		return err;
	}

	return 0;
}
#endif /* IS_ENABLED(CONFIG_USB_DEVICE_STACK_NEXT) */

static void uart_irq_callback(const struct device *dev,
							  void *user_data)
{
	unsigned char ch;

	while (uart_poll_in(dev, &ch) == 0) {
		uart_char_cnt++;
		aee_host_msg_callback(&ch, 1);
	}
	(void)user_data;
}

static bool host_init(void)
{
	//uart_dev = device_get_binding(HOST_DEVICE_COMM_UART_NAME);
	uart_dev =  DEVICE_DT_GET(DT_CHOSEN(zephyr_console));
	if (!uart_dev) {
		printf("UART: Device driver not found.\n");
		return false;
	}
#if defined(CONFIG_USB_DEVICE_STACK_NEXT)
	if (enable_usb_device_next()) {
		return 0;
	}
#else
	if (usb_enable(NULL)) {
		return 0;
	}
#endif
	uart_irq_rx_enable(uart_dev);
	uart_irq_callback_set(uart_dev, uart_irq_callback);
	return true;
}

int host_send(void *ctx, const char *buf, int size)
{
	if (!uart_dev)
		return 0;

	for (int i = 0; i < size; i++)
		uart_poll_out(uart_dev, buf[i]);

	return size;
}

void host_destroy(void)
{
}

static host_interface interface = {
	.init = host_init,
	.send = host_send,
	.destroy = host_destroy
};

static char global_heap_buf[220 * 1024] = { 0 };

static int iwasm_main(void)
{
	RuntimeInitArgs init_args;

	host_init();

	memset(&init_args, 0, sizeof(RuntimeInitArgs));
	init_args.mem_alloc_type = Alloc_With_Pool;
	init_args.mem_alloc_option.pool.heap_buf = global_heap_buf;
	init_args.mem_alloc_option.pool.heap_size = sizeof(global_heap_buf);

	/* initialize runtime environment */
	if (!wasm_runtime_full_init(&init_args)) {
		printf("Init runtime environment failed.\n");
		return -1;
	}

	init_wasm_timer();

	app_manager_startup(&interface);

	wasm_runtime_destroy();
	return -1;
}

void main(void)
{
	iwasm_main();

	while (!dtr) {
		uart_line_ctrl_get(uart_dev, UART_LINE_CTRL_DTR, &dtr);
		/* Give CPU resources to low priority threads. */
		k_sleep(K_MSEC(100));
	}
	for (;;) {
		k_sleep(Z_TIMEOUT_MS(1000));
	}
}
```

## src/pin_config_stm32.h
```c
/*
 * Copyright (c) 2020 Intel Corporation
 *
 * SPDX-License-Identifier: Apache-2.0
 */

#ifndef __PIN_CONFIG_STM32_H__
#define __PIN_CONFIG_STM32_H__

#define DT_ILITEK_ILI9340_0_BUS_NAME "SPI_1"
#define DT_ILITEK_ILI9340_0_SPI_MAX_FREQUENCY (24*1000*1000)

#define DT_ILITEK_ILI9340_0_BASE_ADDRESS      1
#define DT_ILITEK_ILI9340_0_RESET_GPIOS_CONTROLLER "GPIOC"
#define DT_ILITEK_ILI9340_0_RESET_GPIOS_PIN    12
#define DT_ILITEK_ILI9340_0_CMD_DATA_GPIOS_CONTROLLER "GPIOC"
#define DT_ILITEK_ILI9340_0_CMD_DATA_GPIOS_PIN 11

#define DT_ILITEK_ILI9340_0_CS_GPIO_CONTROLLER  "GPIOC"
#define DT_ILITEK_ILI9340_0_CS_GPIO_PIN            10

#define XPT2046_SPI_DEVICE_NAME "SPI_1"
#define XPT2046_SPI_MAX_FREQUENCY (12*1000*1000)
#define XPT2046_CS_GPIO_CONTROLLER "GPIOD"
#define XPT2046_CS_GPIO_PIN         0

#define XPT2046_PEN_GPIO_CONTROLLER "GPIOD"
#define XPT2046_PEN_GPIO_PIN         1

#define HOST_DEVICE_COMM_UART_NAME "LPUART1" //USART3 is used by ST Link

#endif /* __PIN_CONFIG_STM32_H__ */
```
